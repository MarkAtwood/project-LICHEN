## lichen/drivers/gnss/Kconfig
```kconfig
config GNSS_AG3335
	bool "Airoha AG3335 GNSS driver"
	default y
	depends on DT_HAS_AIROHA_AG3335_ENABLED
	select GNSS
	select MODEM_MODULES
	select MODEM_BACKEND_UART
	select MODEM_CHAT
	select GNSS_PARSE
	select GNSS_NMEA0183
	select GNSS_NMEA0183_MATCH
	help
	  Driver for the Airoha AG3335 GNSS receiver. Outputs standard
	  NMEA-0183 at 115200 baud; no host-side init sequence required.

if GNSS_AG3335

config GNSS_AG3335_SATELLITES_COUNT
	int "Maximum satellite count"
	depends on GNSS_SATELLITES
	default 24
	help
	  Maximum number of satellites reported in the satellites callback.

endif # GNSS_AG3335

config GNSS_L76K
	bool "Quectel L76K GNSS driver"
	default y
	depends on DT_HAS_QUECTEL_L76K_ENABLED
	select GNSS
	select MODEM_MODULES
	select MODEM_BACKEND_UART
	select MODEM_CHAT
	select GNSS_PARSE
	select GNSS_NMEA0183
	select GNSS_NMEA0183_MATCH
	help
	  Driver for the Quectel L76K GNSS receiver (T-Echo). Streams
	  standard NMEA-0183 at 9600 baud; PMTK configuration commands are
	  a follow-up bead (sxvf). Standby/backup power via the optional
	  backup GPIO loses ephemeris (cold start on wake).

if GNSS_L76K

config GNSS_L76K_SATELLITES_COUNT
	int "Maximum satellite count"
	depends on GNSS_SATELLITES
	default 24
	help
	  Maximum number of satellites reported in the satellites callback.

endif # GNSS_L76K
```

## lichen/drivers/lora/Kconfig
```kconfig
config LORA_LICHEN_SIM
	bool "LICHEN simulator LoRa driver"
	depends on LORA
	select NET_SOCKETS
	select NET_SOCKETS_POSIX_NAMES
	help
	  TCP client driver for native_sim builds. Connects to the lichen-sim
	  server and presents a LoRa radio interface to the node stack.

if LORA_LICHEN_SIM

config LORA_LICHEN_SIM_HOST
	string "Simulator host address"
	default "127.0.0.1"

config LORA_LICHEN_SIM_PORT
	int "Simulator port"
	default 4444
	range 1 65535

config LORA_LICHEN_SIM_NODE_ID
	string "Node identifier sent to simulator at registration"
	default "node0"
	help
	  ASCII string identifying this node to the simulator (e.g. "gw0",
	  "node1"). Must be unique across all nodes in the simulation.

config LORA_LICHEN_SIM_SIM_ID
	string "Simulation run identifier"
	default "lichen"

config LORA_LICHEN_SIM_RX_THREAD_STACK_SIZE
	int "Simulator async RX thread stack size"
	default 4096
	help
	  Stack size for the lora_recv_async() RX thread. The thread runs
	  push-protocol RX_ENTER windows against the simulator server and
	  delivers frames to the registered callback, which runs the full
	  RX consumer (L2/IPv6/CoAP) on this stack.

config LORA_LICHEN_SIM_RX_THREAD_PRIORITY
	int "Simulator async RX thread priority"
	default 7
	range 0 NUM_PREEMPT_PRIORITIES
	help
	  Priority for the lora_recv_async() RX thread. Lower numbers have
	  higher priority in Zephyr. Valid preemptible values are
	  0..NUM_PREEMPT_PRIORITIES-1 (enforced at runtime when
	  CONFIG_ASSERT=y, the same idiom Zephyr's own Kconfigs use).

endif # LORA_LICHEN_SIM

config LORA_LICHEN_RENODE
	bool "LICHEN Renode LoRa driver"
	depends on LORA
	help
	  Memory-mapped driver for Renode LichenSubGHz peripheral. Bridges
	  to lichen-sim via the C# peripheral's TCP socket.

rsource "lr1110/Kconfig"
```

## lichen/dts/bindings/gnss/quectel,l76k.yaml
```yaml
# SPDX-License-Identifier: Apache-2.0
# Copyright (c) 2024 The contributors to the LICHEN project

description: |
  Quectel L76K GNSS receiver (NMEA-0183 via UART at 9600 baud).

  Streams standard NMEA sentences at 9600 baud. The host sends PMTK
  commands for configuration (output message set, update rate).
  Standby/backup power uses V_BACKUP (RTC domain) and an optional
  FORCE_ON pin; entering backup loses ephemeris and requires a
  cold-start wake.

  Example (nRF52840, T-Echo UART1 pin assignments):

    &uart1 {
      current-speed = <9600>;
      ...
      gnss0: l76k {
        compatible = "quectel,l76k";
        backup-gpios = <&gpio0 2 GPIO_ACTIVE_HIGH>;
        force-on-gpios = <&gpio0 9 GPIO_ACTIVE_HIGH>;
      };
    };

compatible: "quectel,l76k"

include:
  - uart-device.yaml

properties:
  backup-gpios:
    type: phandle-array
    required: false
    description: |
      V_BACKUP / EXINT control (active HIGH). When provided, PM_DEVICE
      suspend pulls it low to enter backup mode; resume releases it.

  force-on-gpios:
    type: phandle-array
    description: |
      FORCE_ON — optional wake/force-on pin. Optional; unused by the
      driver today but wired on some T-Echo variants.
```

## lichen/subsys/lichen/diag/Kconfig
```kconfig
# SPDX-License-Identifier: GPL-3.0-or-later
# SPDX-FileCopyrightText: The contributors to the LICHEN project

config LICHEN_DIAG
	bool "Hardware diagnostics event ring"
	depends on LICHEN_COAP_SERVER
	default y
	help
	  Rolling ring buffer of diagnostic events (timestamp, subsystem,
	  event code, detail, message) callable from any subsystem via
	  lichen_diag_report(). Each event prints human-readable over the
	  console; GET /diag returns the recent events as a CBOR array for
	  remote inspection (spec 18.x LCI diagnostics family).

config LICHEN_DIAG_CAPACITY
	int "Diagnostic event ring capacity"
	depends on LICHEN_DIAG
	default 32
	range 4 256
	help
	  Number of events retained in the ring. Oldest events are
	  overwritten first.
```

## lichen/subsys/lichen/gateway/Kconfig
```kconfig
# SPDX-License-Identifier: GPL-3.0-or-later
# SPDX-FileCopyrightText: The contributors to the LICHEN project

config LICHEN_TUNNEL_AUTH
	bool "Fail-closed egress tunnel authorization"
	depends on LICHEN_LINK_SCHNORR
	select LICHEN_CRYPTO_MONOCYPHER
	select MBEDTLS
	select MBEDTLS_SHA256
	help
	  Verify root-issued COSE_Sign1 tunnel grants and enforce them before
	  forwarding inner IPv6 packets to an external interface.

config LICHEN_CAPABILITY_ANNOUNCE
	bool "Capability announcement verification (spec 8.12)"
	depends on LICHEN_LINK_SCHNORR
	select LICHEN_CRYPTO_MONOCYPHER
	select TINYCRYPT
	select TINYCRYPT_SHA256
	select LICHEN_TUNNEL_AUTH
	help
	  Verify node capability announcements (COSE_Sign1, Schnorr48) received
	  by the DODAG root per spec/06-security.md section 8.12. The CoAP
	  resource reuses tunnel_auth's OSCORE authorize helper and sender-IID
	  extraction, so it selects LICHEN_TUNNEL_AUTH.

if LICHEN_CAPABILITY_ANNOUNCE

config LICHEN_CAPABILITY_TABLE_CAPACITY
	int "Maximum capability table entries (spec 8.12)"
	default 256
	range 4 512
	help
	  Bounded LRU capability table. The spec-recommended capacity is 256
	  with up to 25% reserved for egress-bit announcements.

endif

if LICHEN_TUNNEL_AUTH

config LICHEN_TUNNEL_AUTH_MAX_ENTRIES
	int "Maximum active tunnel grants"
	default 8
	range 1 32

config LICHEN_TUNNEL_AUTH_MAX_HISTORY
	int "Maximum retained replay/revocation floors"
	default 32
	range LICHEN_TUNNEL_AUTH_MAX_ENTRIES 128

endif
```

## lichen/subsys/lichen/hmi/Kconfig
```kconfig
# SPDX-License-Identifier: GPL-3.0-or-later
# SPDX-FileCopyrightText: The contributors to the LICHEN project

# LICHEN HMI subsystem Kconfig (spec 19 device UX design language)

menuconfig LICHEN_HMI_LED
	bool "LED language driver (spec 19 §10 fixed state table)"
	depends on LICHEN
	help
	  Fixed six-state LED table: joined-idle=off, joining=0.5Hz/10%,
	  message-waiting=0.25Hz/5%, SOS-active=2Hz/50%,
	  hold-in-progress=4Hz/50%, fault=1Hz/50%.
	  Board glue drives the LED from lichen_hmi_led_is_on().
```

## lichen/subsys/lichen/ux/Kconfig
```kconfig
# SPDX-License-Identifier: GPL-3.0-or-later
# SPDX-FileCopyrightText: The contributors to the LICHEN project

config LICHEN_UX
	bool "LICHEN device UX (spec 19)"
	depends on LICHEN
	default y
	help
	  Device UX components from spec/19-device-ux.md. Compiles the pure,
	  host-testable engines (LED timing, etc.); GPIO/display backends are
	  individually selectable.

config LICHEN_UX_LED
	bool "Spec 19 §10 LED status language (led0 blink engine)"
	depends on LICHEN_UX
	default y
	help
	  Drive the device status LED with the fixed 6-state blink table from
	  spec 19 §10 (joined-idle off, joining, message-waiting, SOS, hold,
	  fault). Selects the GPIO backend that drives led0 via the HAL.
	  Boards set CONFIG_LICHEN_HAS_LEDS (which BUILD_ASSERTs an led0 alias);
	  targets with no LED (hal_led_get fails) degrade to a quiet no-op and
	  the driver does not schedule any periodic work.

config LICHEN_UX_BUTTON
	bool "Spec 19 §4/§8/§9 button interaction grammar (screen ring + SOS + reset)"
	depends on LICHEN_UX
	depends on LICHEN_UX_LED
	default y
	help
	  Drive the user button with the universal interaction grammar from
	  spec 19 §4: short-press advances the screen ring, hold >=2s arms
	  SOS (single-button hardware, §8), hold >=5s opens the guarded
	  factory-reset path (§9), with mandatory hold feedback within 500 ms
	  (the H-tier LED switches to the 4 Hz hold pattern, §10). The pure
	  grammar engine is always compiled; this selects the GPIO backend
	  that reads the user button via the HAL. Targets with no button
	  (hal_button_get fails) degrade to a quiet no-op.
```

## lichen/tests/checkin_resource/testcase.yaml
```yaml
# SPDX-License-Identifier: GPL-3.0-or-later
# SPDX-FileCopyrightText: The contributors to the LICHEN project

common:
  # R-APPC-009 (spec/appendix-c-safety.md): ASan+UBSan on native_sim builds.
  extra_conf_files:
    - ../../tests/sanitizers.conf
tests:
  lichen.checkin_resource:
    tags:
      - coap
      - checkin
      - rollcall
    platform_allow:
      - native_sim
      - native_sim/native/64
      - qemu_x86
      - qemu_x86_64
    integration_platforms:
      - qemu_x86
      - qemu_x86_64
```

## lichen/tests/gnss_emul/testcase.yaml
```yaml
# SPDX-License-Identifier: GPL-3.0-or-later
# SPDX-FileCopyrightText: The contributors to the LICHEN project

common:
  # R-APPC-009 (spec/appendix-c-safety.md): ASan+UBSan on native_sim builds.
  extra_conf_files:
    - ../../tests/sanitizers.conf
tests:
  net.lichen.gnss_emul:
    tags:
      - net
      - lichen
      - gnss
      - simulation
    platform_allow:
      - native_sim
      - native_sim/native/64
      - qemu_x86
      - qemu_x86_64
    integration_platforms:
      - qemu_x86
    timeout: 30
```

## lichen/tests/gnss_l76k/testcase.yaml
```yaml
tests:
  gnss.l76k.build:
    platform_allow: native_sim/native/64 native_sim
    tags: gnss
```

## lichen/tests/inbound_lci_location/testcase.yaml
```yaml
common:
  tags:
    - lichen
    - gateway
    - lci
    - location
  # R-APPC-009 (spec/appendix-c-safety.md): ASan+UBSan on native_sim builds.
  extra_conf_files:
    - ../../tests/sanitizers.conf
tests:
  net.lichen.inbound_lci_location.native:
    platform_allow:
      - native_sim
      - native_sim/native/64
    integration_platforms:
      - native_sim
      - native_sim/native/64
  net.lichen.inbound_lci_location.qemu:
    platform_allow:
      - qemu_x86
    integration_platforms:
      - qemu_x86
    extra_configs:
      - CONFIG_NET_TEST=y
```

## lichen/tests/meshcore_adapter/testcase.yaml
```yaml
# SPDX-License-Identifier: GPL-3.0-or-later
# SPDX-FileCopyrightText: The contributors to the LICHEN project

tests:
  net.lichen.meshcore_adapter:
    extra_conf_files:
    - ../../tests/sanitizers.conf
    platform_allow:
      - native_sim
      - native_sim/native/64
    tags: meshcore
  net.lichen.meshcore_adapter.identity:
    platform_allow:
      - native_sim
      - native_sim/native/64
    tags: meshcore app-identity
    extra_args:
      - CONF_FILE=prj.conf;prj_identity.conf;../../tests/sanitizers.conf
```

## lichen/tests/multi_root/testcase.yaml
```yaml
# SPDX-License-Identifier: GPL-3.0-or-later
# SPDX-FileCopyrightText: The contributors to the LICHEN project

common:
  tags:
    - lichen
    - rpl
  extra_conf_files:
    - ../../tests/sanitizers.conf
tests:
  net.lichen.multi_root:
    platform_allow:
      - qemu_x86
      - native_sim
      - native_sim/native/64
    integration_platforms:
      - qemu_x86
```

## lichen/tests/schc_failure_tracker/testcase.yaml
```yaml
# SPDX-License-Identifier: GPL-3.0-or-later
# SPDX-FileCopyrightText: The contributors to the LICHEN project

common:
  tags:
    - lichen
    - schc
  extra_conf_files:
    - ../../tests/sanitizers.conf
tests:
  net.schc.failure_tracker:
    platform_allow:
      - qemu_x86
      - native_sim
      - native_sim/native/64
    integration_platforms:
      - native_sim
```
