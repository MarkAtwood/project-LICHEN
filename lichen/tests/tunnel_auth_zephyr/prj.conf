## prj.conf
```kconfig
# SPDX-License-Identifier: GPL-3.0-or-later
# SPDX-FileCopyrightText: The contributors to the LICHEN project

CONFIG_ZTEST=y
CONFIG_LICHEN=y
CONFIG_LICHEN_LINK=y
CONFIG_LICHEN_LINK_SCHNORR=y
CONFIG_LICHEN_TUNNEL_AUTH=y
CONFIG_LICHEN_TUNNEL_AUTH_MAX_ENTRIES=2
CONFIG_LICHEN_TUNNEL_AUTH_MAX_HISTORY=4
# Compile the standalone coap_server so the CONFIG_LICHEN_TUNNEL_AUTH-gated
# /.well-known/tunnel-auth resource (coap_server.c) is build-validated here.
# The standalone server needs the SLIP transport, which needs the net stack.
CONFIG_NETWORKING=y
CONFIG_NET_IPV6=y
CONFIG_NET_UDP=y
CONFIG_NET_SOCKETS=y
CONFIG_SERIAL=y
CONFIG_NET_L2_DUMMY=y
# coap_server.c BUILD_ASSERTs require >= LICHEN_COAP_SERVER_MAX_PAYLOAD (512) + 128
CONFIG_COAP_SERVER_MESSAGE_SIZE=896
CONFIG_LICHEN_COAP=y
CONFIG_LICHEN_COAP_SERVER=y
CONFIG_LICHEN_COAP_SERVER_STANDALONE=y
CONFIG_LICHEN_COAP_KEYS=y
CONFIG_LICHEN_OSCORE=y
CONFIG_LICHEN_SLIP_TRANSPORT=y
CONFIG_LICHEN_SENML=y
CONFIG_MAIN_STACK_SIZE=4096
CONFIG_ZTEST_STACK_SIZE=4096
CONFIG_ASSERT=y

# Zephyr's COAP_CLIENT_THREAD_PRIORITY defaults to NUM_PREEMPT_PRIORITIES
# (= the idle priority), which asserts at z_init_static_threads; same
# override the coap_client and ping_l2 tests use.
CONFIG_COAP_CLIENT_THREAD_PRIORITY=14

# No CONFIG_THREAD_ANALYZER here: it depends on !ARCH_POSIX and this suite
# only builds on native_sim, so assigning it aborts the Kconfig merge
# (project-LICHEN-worker6-52yd). R-APPC-007 applies to hardware builds.

# System heap validation (spec appendix-c-safety.md R-APPC-008, debug builds)
CONFIG_SYS_HEAP_VALIDATE=y
```

## src/main.c
```c
/* SPDX-License-Identifier: GPL-3.0-or-later */
/* SPDX-FileCopyrightText: The contributors to the LICHEN project */

#include <zephyr/ztest.h>
#include <lichen/gateway/tunnel_auth.h>

static struct lichen_tunnel_auth_ctx fresh_with(const uint8_t root[8], const uint8_t egress[16],
						const uint8_t pubkey[32]);
static struct lichen_tunnel_result receive_as(struct lichen_tunnel_auth_ctx *ctx,
	const uint8_t *wire, size_t len, bool authenticated, const uint8_t sender[8], uint64_t now);
static void check_result(const char *name, struct lichen_tunnel_result result,
	bool allowed, enum lichen_tunnel_denial denial, uint16_t code);
static void fixture_assert(bool condition);

#include "tunnel_auth_vectors.h"

static struct lichen_tunnel_auth_ctx fresh_with(const uint8_t root[8], const uint8_t egress[16],
						const uint8_t pubkey[32])
{
	struct lichen_tunnel_auth_ctx ctx;
	struct lichen_tunnel_crypto crypto;
	zassert_ok(lichen_tunnel_auth_default_crypto(&crypto));
	zassert_ok(lichen_tunnel_auth_init(&ctx, egress_iid, egress, root, pubkey, &crypto));
	return ctx;
}

static struct lichen_tunnel_result receive_as(struct lichen_tunnel_auth_ctx *ctx,
	const uint8_t *wire, size_t len, bool authenticated, const uint8_t sender[8], uint64_t now)
{ return lichen_tunnel_auth_receive(ctx, wire, len, authenticated, sender, now); }

static void check_result(const char *name, struct lichen_tunnel_result result,
	bool allowed, enum lichen_tunnel_denial denial, uint16_t code)
{
	zassert_equal(result.allowed, allowed, "%s allowed", name);
	zassert_equal(result.denial, denial, "%s denial", name);
	zassert_equal(result.coap_code, code, "%s CoAP code", name);
}

static void fixture_assert(bool condition) { zassert_true(condition); }

ZTEST(tunnel_auth, test_complete_shared_decision_corpus)
{
	run_fixture_post_cases();
	run_fixture_decap_cases();
}

ZTEST(tunnel_auth, test_canonical_vector_and_data_plane)
{
	struct lichen_tunnel_crypto crypto;
	struct lichen_tunnel_auth_ctx ctx;
	struct lichen_tunnel_result result;
	uint8_t source[16] = { 0x02, 0x00, 0x12, 0x34, 0x56, [15] = 1 };
	uint8_t destination[16] = { 0x20, 0x01, 0x0d, 0xb8, [15] = 1 };

	zassert_ok(lichen_tunnel_auth_default_crypto(&crypto));
	zassert_ok(lichen_tunnel_auth_init(&ctx, egress_iid, egress_addr, root_iid, root_pubkey, &crypto));
	result = lichen_tunnel_auth_receive(&ctx, wire_valid, sizeof(wire_valid), true,
					    root_iid, UINT64_C(1900000000));
	zassert_true(result.allowed);
	result = lichen_tunnel_auth_decapsulate(&ctx, source, destination, valid_route, 2,
						LICHEN_TUNNEL_MESH_TO_EXTERNAL,
						UINT64_C(1900000001));
	zassert_true(result.allowed);
}

ZTEST(tunnel_auth, test_fail_closed_boundaries)
{
	struct lichen_tunnel_crypto crypto;
	struct lichen_tunnel_auth_ctx ctx;
	struct lichen_tunnel_result result;

	zassert_ok(lichen_tunnel_auth_default_crypto(&crypto));
	zassert_ok(lichen_tunnel_auth_init(&ctx, egress_iid, egress_addr, root_iid, root_pubkey, &crypto));
	result = lichen_tunnel_auth_receive(&ctx, wire_valid, sizeof(wire_valid), false,
					    root_iid, UINT64_C(1900000000));
	zassert_equal(result.denial, LICHEN_TUNNEL_DENIAL_OSCORE_REQUIRED);
	result = lichen_tunnel_auth_receive(&ctx, wire_noncanonical_outer,
					    sizeof(wire_noncanonical_outer), true,
					    root_iid, UINT64_C(1900000000));
	zassert_equal(result.denial, LICHEN_TUNNEL_DENIAL_MALFORMED);
	result = lichen_tunnel_auth_receive(&ctx, wire_wrong_signer,
					    sizeof(wire_wrong_signer), true,
					    root_iid, UINT64_C(1900000000));
	zassert_equal(result.denial, LICHEN_TUNNEL_DENIAL_SIGNATURE);
}

ZTEST_SUITE(tunnel_auth, NULL, NULL, NULL, NULL, NULL);
```
