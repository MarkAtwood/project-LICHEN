## lichen/west.yml
```yaml
manifest:
  version: "0.13"

  self:
    path: lichen

  defaults:
    remote: zephyrproject

  remotes:
    - name: zephyrproject
      url-base: https://github.com/zephyrproject-rtos

  projects:
    - name: zephyr
      remote: zephyrproject
      revision: v4.1.0
      import: true
```
