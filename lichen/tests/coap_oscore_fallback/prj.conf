## CMakeLists.txt
```
# SPDX-License-Identifier: GPL-3.0-or-later
# SPDX-FileCopyrightText: The contributors to the LICHEN project

cmake_minimum_required(VERSION 3.20.0)
find_package(Zephyr REQUIRED HINTS $ENV{ZEPHYR_BASE})
project(coap_oscore_fallback)

FILE(GLOB app_sources src/*.c)
target_sources(app PRIVATE ${app_sources})
target_sources(app PRIVATE ../../subsys/lichen/coap/coap_server.c)
target_include_directories(app PRIVATE
  ../../subsys/lichen/senml/include
  ../../subsys/lichen/gateway/include
)

# Per-service CoAP resource sections (mirrors zephyr/tests/net/lib/coap_server).
zephyr_linker_sources(DATA_SECTIONS sections-ram.ld)

# Inbox handler regression captures only that resource's sends. Other suite
# resources still use the real CoAP service/socket implementation.
zephyr_ld_options(
  -Wl,--wrap=coap_service_start
  -Wl,--wrap=coap_resource_send
)
```

## prj.conf
```kconfig
# SPDX-License-Identifier: GPL-3.0-or-later
# SPDX-FileCopyrightText: The contributors to the LICHEN project

CONFIG_ZTEST=y
CONFIG_ZTEST_STACK_SIZE=4096
CONFIG_MAIN_STACK_SIZE=4096

CONFIG_LOG=y
CONFIG_PRINTK=y

CONFIG_NETWORKING=y
CONFIG_NET_TEST=y
CONFIG_ENTROPY_GENERATOR=y
CONFIG_TEST_RANDOM_GENERATOR=y

CONFIG_NET_IPV6=y
CONFIG_NET_IPV4=n
CONFIG_NET_SOCKETS=y
CONFIG_NET_LOOPBACK=y
CONFIG_NET_IF_MAX_IPV6_COUNT=2
CONFIG_NET_PKT_RX_COUNT=8
CONFIG_NET_PKT_TX_COUNT=8
CONFIG_NET_BUF_RX_COUNT=16
CONFIG_NET_BUF_TX_COUNT=16
CONFIG_NET_IPV6_DAD=n
CONFIG_NET_IPV6_ND=n
CONFIG_NET_IPV6_NBR_CACHE=n
CONFIG_NET_IPV6_MLD=n

# The suite binds 127.0.0.1/::1 sockets for response capture, which needs
# the loopback driver: NET_TEST=y excludes all net drivers, so re-enable
# them (this makes the CONFIG_NET_LOOPBACK=y above actually take effect).
CONFIG_NET_DRIVERS=y

CONFIG_COAP=y
CONFIG_COAP_SERVER=y
CONFIG_COAP_SERVICE_PENDING_MESSAGES=2
CONFIG_COAP_SERVICE_OBSERVERS=1

CONFIG_LICHEN=y
CONFIG_LICHEN_COAP=y
CONFIG_LICHEN_COAP_SERVER=y
CONFIG_LICHEN_COAP_CLIENT=n
# No client thread in this test (its default priority 15 panics on
# native_sim's 15-priority preempt range).
CONFIG_LICHEN_COAP_STATUS=n
# Not under test. lichen_rollcall_render() exceeds this host toolchain's
# -Wstack-usage=2048 limit (3424B on x86_64-zephyr-elf gcc) and this suite
# does not exercise it (pre-existing, tracked separately).
CONFIG_LICHEN_CHECKIN=n
# LICHEN_COAP_SERVER scopes admin access to the SLIP LCI interface, so that
# must be present for the module to compile and link (see coap_keys).
CONFIG_LICHEN_SLIP_TRANSPORT=y
CONFIG_SERIAL=y
CONFIG_RING_BUFFER=y
CONFIG_LICHEN_OSCORE=y
CONFIG_LICHEN_COAP_SERVER_OSCORE=y
CONFIG_LICHEN_LINK=y

CONFIG_TINYCRYPT=y
CONFIG_TINYCRYPT_SHA256=y

# C Safety Policy - spec/appendix-c-safety.md
CONFIG_STACK_CANARIES=y
CONFIG_STACK_SENTINEL=y
CONFIG_ASSERT=y

CONFIG_ASSERT_VERBOSE=y

# Status/neighbors CBOR maxima (512) must fit the server message buffer
CONFIG_COAP_SERVER_MESSAGE_SIZE=1024

# No CONFIG_THREAD_ANALYZER here: it depends on !ARCH_POSIX and this suite
# only builds on native_sim, so assigning it aborts the Kconfig merge
# (project-LICHEN-worker6-52yd). R-APPC-007 applies to hardware builds.

# System heap validation (spec appendix-c-safety.md R-APPC-008, debug builds)
CONFIG_SYS_HEAP_VALIDATE=y
```

## src/main.c
```c
/* SPDX-License-Identifier: GPL-3.0-or-later */
/* SPDX-FileCopyrightText: The contributors to the LICHEN project */

/**
 * @file main.c
 * @brief Failure semantics of coap_oscore_respond_resource().
 *
 * Regression coverage for the cleartext-downgrade fix: when
 * coap_oscore_protect_response() fails for an OSCORE-protected request, the
 * helper must never send a cleartext reply. It must retry once with a
 * protected empty 5.00 through the same context and correlation, and drop
 * the response silently if that retry also fails. The plain (unprotected)
 * request path must keep its cleartext behavior.
 *
 * The test drives the real helper and captures what it sends through the
 * real Zephyr CoAP service socket: a UDP client socket bound to the IPv6
 * loopback receives exactly what coap_resource_send() emits.
 */

#include <string.h>
#include <zephyr/kernel.h>
#include <zephyr/ztest.h>
#include <zephyr/net/socket.h>
#include <zephyr/net/coap.h>
#include <zephyr/net/coap_service.h>
#include <zephyr/net/net_ip.h>
#include <zephyr/posix/fcntl.h>

#include <lichen/coap_oscore.h>
#include <lichen/oscore.h>

#define CAPTURE_BUF_LEN 256
#define CAPTURE_TIMEOUT_MS 1000
#define DROP_TIMEOUT_MS 200

/* Guaranteed to exceed the protect plaintext budget, so the first
 * protect_response attempt fails with OSCORE_ERR_BUFFER_TOO_SMALL. */
#define OVERSIZE_EXTRA 64

static const uint8_t master_secret[16] = {
	1, 2, 3, 4, 5, 6, 7, 8, 9, 10, 11, 12, 13, 14, 15, 16,
};
static const uint8_t master_salt[8] = {
	0x9e, 0x7c, 0xa9, 0x22, 0x23, 0x78, 0x63, 0x40,
};

static struct oscore_ctx *server_ctx;
static struct oscore_ctx *client_ctx;
static struct oscore_ctx_ref server_ref;

static int client_fd = -1;
static struct sockaddr_in6 client_addr;

static uint8_t oversize_payload[CONFIG_LICHEN_OSCORE_PLAINTEXT_MAX + OVERSIZE_EXTRA];

static const uint16_t fb_svc_port = 56831;
COAP_SERVICE_DEFINE(fb_svc, NULL, &fb_svc_port, 0);

static const char * const fb_path[] = { "fb", NULL };

/*
 * lichen_coap_respond() is NOT stubbed here: this suite sets
 * CONFIG_LICHEN_COAP_SERVER=y, so the real implementation
 * (subsys/lichen/coap/coap_respond.c) links in and the plain-request
 * assertions below exercise it directly. A local double would collide with
 * it at link time (multiple definition).
 */
static int fb_handler(struct coap_resource *resource, struct coap_packet *request,
		      struct sockaddr *addr, socklen_t addr_len)
{
	ARG_UNUSED(resource);
	ARG_UNUSED(request);
	ARG_UNUSED(addr);
	ARG_UNUSED(addr_len);

	return 0;
}

COAP_RESOURCE_DEFINE(fb_res, fb_svc, {
	.path = fb_path,
	.get = fb_handler,
	.post = fb_handler,
});

static void *suite_setup(void)
{
	int ret;

	oscore_init();
	oscore_nvm_register_callbacks(NULL, NULL);

	/* Server context: sender_id = {0x01}, recipient_id = "" */
	ret = oscore_ctx_create(master_secret, master_salt, sizeof(master_salt),
				(uint8_t[]){0x01}, 1, NULL, 0, &server_ctx);
	zassert_equal(ret, OSCORE_OK, "server ctx create failed: %d", ret);
	zassert_not_null(server_ctx);
	/* Capture lifetime evidence by authenticating the published RFC 8613
	 * C.4 request; never manufacture a reference from a pointer at reply. */
	const uint8_t peer[8] = {1};
	const uint8_t ct[] = {0x61, 0x2f, 0x10, 0x92, 0xf1, 0x77, 0x6f,
		0x1c, 0x16, 0x68, 0xb3, 0x82, 0x5e};
	uint8_t code, options[8], payload[8];
	size_t options_len = sizeof(options), payload_len = sizeof(payload);
	zassert_ok(oscore_ctx_set_peer_eui64(server_ctx, peer));
	zassert_ok(oscore_unprotect_request_by_peer(peer, (uint8_t[]){9, 20}, 2,
		ct, sizeof(ct), &code, options, &options_len, payload, &payload_len, &server_ref));
	/* Client context: sender_id = "", recipient_id = {0x01} */
	ret = oscore_ctx_create(master_secret, master_salt, sizeof(master_salt),
				NULL, 0, (uint8_t[]){0x01}, 1, &client_ctx);
	zassert_equal(ret, OSCORE_OK, "client ctx create failed: %d", ret);
	zassert_not_null(client_ctx);

	client_fd = zsock_socket(AF_INET6, SOCK_DGRAM, 0);
	zassert_true(client_fd >= 0, "client socket failed: %d", -errno);

	memset(&client_addr, 0, sizeof(client_addr));
	client_addr.sin6_family = AF_INET6;
	client_addr.sin6_addr = in6addr_loopback;
	client_addr.sin6_port = 0;

	ret = zsock_bind(client_fd, (struct sockaddr *)&client_addr,
			 sizeof(client_addr));
	zassert_equal(ret, 0, "client bind failed: %d", -errno);

	socklen_t alen = sizeof(client_addr);
	ret = zsock_getsockname(client_fd, (struct sockaddr *)&client_addr, &alen);
	zassert_equal(ret, 0, "getsockname failed: %d", -errno);

	/*
	 * Attach the service socket by hand instead of coap_service_start():
	 * the observable contract the helper relies on is that
	 * coap_resource_send() finds fb_svc in the service section and
	 * sendto()s through data->sock_fd. (coap_service_start() deadlocks
	 * under this test's threading on qemu_x86; the manual wiring keeps
	 * everything the helper touches real.)
	 */
	int svc_fd = zsock_socket(AF_INET6, SOCK_DGRAM, 0);

	zassert_true(svc_fd >= 0, "service socket failed: %d", -errno);

	struct sockaddr_in6 svc_addr;

	memset(&svc_addr, 0, sizeof(svc_addr));
	svc_addr.sin6_family = AF_INET6;
	svc_addr.sin6_addr = in6addr_any;
	svc_addr.sin6_port = htons(fb_svc_port);

	ret = zsock_bind(svc_fd, (struct sockaddr *)&svc_addr, sizeof(svc_addr));
	zassert_equal(ret, 0, "service bind failed: %d", -errno);

	ret = zsock_fcntl(svc_fd, F_SETFL, O_NONBLOCK);
	zassert_equal(ret, 0, "service fcntl failed: %d", -errno);

	fb_svc.data->sock_fd = svc_fd;

	return NULL;
}

static int build_request(struct coap_packet *req, uint8_t *buf, size_t buflen,
			 uint16_t mid, const uint8_t *token, uint8_t tkl)
{
	return coap_packet_init(req, buf, (uint16_t)buflen, COAP_VERSION_1,
				COAP_TYPE_CON, tkl, token, COAP_METHOD_POST, mid);
}

/* Receive and parse one response on the client socket; false on timeout. */
static bool capture_response(struct coap_packet *resp, uint8_t *buf,
			     size_t buflen, size_t *recv_len, int timeout_ms)
{
	struct zsock_pollfd pfd = {
		.fd = client_fd,
		.events = ZSOCK_POLLIN,
		.revents = 0,
	};
	static struct coap_option opts[8];

	int ret = zsock_poll(&pfd, 1, timeout_ms);
	if (ret < 1) {
		return false;
	}

	ssize_t n = zsock_recv(client_fd, buf, buflen, ZSOCK_MSG_DONTWAIT);
	if (n <= 0) {
		return false;
	}
	*recv_len = (size_t)n;

	return coap_packet_parse(resp, buf, *recv_len, opts, 8) == 0;
}

static bool has_oscore_option(const struct coap_packet *resp)
{
	struct coap_option opt;

	return coap_find_options(resp, COAP_OPTION_OSCORE, &opt, 1) > 0;
}

static void suite_teardown(void *fixture)
{
	ARG_UNUSED(fixture);
	oscore_ctx_free(server_ctx);
	oscore_ctx_free(client_ctx);
}

ZTEST_SUITE(coap_oscore_fallback, NULL, suite_setup, NULL, NULL, suite_teardown);

/*
 * A protected request with a normal payload round-trips: the response
 * arrives OSCORE-protected and decrypts to the requested code and payload.
 */
ZTEST(coap_oscore_fallback, test_protected_response_roundtrip)
{
	static const uint8_t token[] = {0xA1, 0xA2, 0xA3, 0xA4};
	static const uint8_t piv[] = {0x11};
	static const uint8_t payload[] = "lich-en";

	uint8_t req_buf[64];
	uint8_t cap_buf[CAPTURE_BUF_LEN];
	struct coap_packet req;
	struct coap_packet resp;
	struct coap_oscore_unprotect_result result;
	size_t recv_len = 0;
	int ret;

	ret = build_request(&req, req_buf, sizeof(req_buf), 1001,
			    token, sizeof(token));
	zassert_equal(ret, 0, "request build failed: %d", ret);

	memset(&result, 0, sizeof(result));
	result.is_protected = true;
	result.ctx = server_ctx;
	result.origin.response_ctx = server_ref;
	memcpy(result.piv, piv, sizeof(piv));
	result.piv_len = sizeof(piv);

	ret = coap_oscore_respond_resource(&fb_res, &req,
					   (struct sockaddr *)&client_addr,
					   sizeof(client_addr), &result,
					   COAP_RESPONSE_CODE_CHANGED, 0,
					   payload, sizeof(payload) - 1);
	zassert_equal(ret, 0, "respond failed: %d", ret);

	ret = capture_response(&resp, cap_buf, sizeof(cap_buf), &recv_len,
			       CAPTURE_TIMEOUT_MS);
	zassert_true(ret, "no response captured");
	zassert_true(has_oscore_option(&resp), "response must carry OSCORE option");

	uint16_t ct_len16 = 0;
	size_t ct_len;
	const uint8_t *ct = coap_packet_get_payload(&resp, &ct_len16);

	ct_len = ct_len16;
	zassert_not_null(ct, "no ciphertext in response");

	uint8_t oscore_opt[32];
	size_t opt_len = sizeof(oscore_opt);
	zassert_equal(coap_oscore_get_option(&resp, oscore_opt, &opt_len),
		      OSCORE_OK, "missing OSCORE option");

	uint8_t code = 0;
	uint8_t dopts[32];
	size_t dopts_len = sizeof(dopts);
	uint8_t dpl[64];
	size_t dpl_len = sizeof(dpl);
	ret = oscore_unprotect_response(client_ctx, piv, sizeof(piv),
					oscore_opt, opt_len, ct, ct_len,
					&code, dopts, &dopts_len, dpl, &dpl_len);
	zassert_equal(ret, OSCORE_OK, "client unprotect failed: %d", ret);
	zassert_equal(code, COAP_RESPONSE_CODE_CHANGED, "inner code mismatch");
	zassert_equal(dopts_len, 0U, "cf=0 must omit the inner Content-Format");
	zassert_equal(dpl_len, sizeof(payload) - 1U, "inner payload length mismatch");
	zassert_mem_equal(dpl, payload, sizeof(payload) - 1U, "inner payload mismatch");
}

/*
 * A nonzero content_format must survive protection: Content-Format is Class
 * E under OSCORE, so the inner message decrypts with the encoded option
 * (0xc1 0x3c = Content-Format: 60, application/cbor) — wire parity with the
 * Rust gateway, which emits it on every protected response with cf != 0.
 */
ZTEST(coap_oscore_fallback, test_protected_response_carries_content_format)
{
	static const uint8_t token[] = {0x9A, 0x9B, 0x9C, 0x9D};
	static const uint8_t piv[] = {0x15};
	static const uint8_t payload[] = {0xa1, 0x01, 0x02}; /* CBOR body */

	uint8_t req_buf[64];
	uint8_t cap_buf[CAPTURE_BUF_LEN];
	struct coap_packet req;
	struct coap_packet resp;
	struct coap_oscore_unprotect_result result;
	size_t recv_len = 0;
	int ret;

	ret = build_request(&req, req_buf, sizeof(req_buf), 1007,
			    token, sizeof(token));
	zassert_equal(ret, 0, "request build failed: %d", ret);

	memset(&result, 0, sizeof(result));
	result.is_protected = true;
	result.ctx = server_ctx;
	result.origin.response_ctx = server_ref;
	memcpy(result.piv, piv, sizeof(piv));
	result.piv_len = sizeof(piv);

	ret = coap_oscore_respond_resource(&fb_res, &req,
					   (struct sockaddr *)&client_addr,
					   sizeof(client_addr), &result,
					   COAP_RESPONSE_CODE_CHANGED, 60,
					   payload, sizeof(payload));
	zassert_equal(ret, 0, "respond failed: %d", ret);

	ret = capture_response(&resp, cap_buf, sizeof(cap_buf), &recv_len,
			       CAPTURE_TIMEOUT_MS);
	zassert_true(ret, "no response captured");
	zassert_true(has_oscore_option(&resp), "response must carry OSCORE option");

	uint16_t ct_len16 = 0;
	size_t ct_len;
	const uint8_t *ct = coap_packet_get_payload(&resp, &ct_len16);

	ct_len = ct_len16;
	zassert_not_null(ct, "no ciphertext in response");

	uint8_t oscore_opt[32];
	size_t opt_len = sizeof(oscore_opt);
	zassert_equal(coap_oscore_get_option(&resp, oscore_opt, &opt_len),
		      OSCORE_OK, "missing OSCORE option");

	uint8_t code = 0;
	uint8_t dopts[32];
	size_t dopts_len = sizeof(dopts);
	uint8_t dpl[64];
	size_t dpl_len = sizeof(dpl);
	ret = oscore_unprotect_response(client_ctx, piv, sizeof(piv),
					oscore_opt, opt_len, ct, ct_len,
					&code, dopts, &dopts_len, dpl, &dpl_len);
	zassert_equal(ret, OSCORE_OK, "client unprotect failed: %d", ret);
	zassert_equal(code, COAP_RESPONSE_CODE_CHANGED, "inner code mismatch");
	zassert_equal(dopts_len, 2U, "inner Content-Format option missing");
	zassert_mem_equal(dopts, ((uint8_t[]){0xc1, 60}), 2U,
			  "inner Content-Format must be 0xc1 0x3c");
	zassert_equal(dpl_len, sizeof(payload), "inner payload length mismatch");
	zassert_mem_equal(dpl, payload, sizeof(payload), "inner payload mismatch");
}

/*
 * The bead's fix: protect failure for a protected request (payload beyond
 * the plaintext budget) must produce a PROTECTED empty 5.00, never a
 * cleartext reply.
 */
ZTEST(coap_oscore_fallback, test_protect_failure_sends_protected_empty_500)
{
	static const uint8_t token[] = {0xB1, 0xB2, 0xB3, 0xB4};
	static const uint8_t piv[] = {0x12};

	uint8_t req_buf[64];
	uint8_t cap_buf[CAPTURE_BUF_LEN];
	struct coap_packet req;
	struct coap_packet resp;
	struct coap_oscore_unprotect_result result;
	size_t recv_len = 0;
	int ret;

	ret = build_request(&req, req_buf, sizeof(req_buf), 1002,
			    token, sizeof(token));
	zassert_equal(ret, 0, "request build failed: %d", ret);

	memset(&result, 0, sizeof(result));
	result.is_protected = true;
	result.ctx = server_ctx;
	result.origin.response_ctx = server_ref;
	memcpy(result.piv, piv, sizeof(piv));
	result.piv_len = sizeof(piv);

	ret = coap_oscore_respond_resource(&fb_res, &req,
					   (struct sockaddr *)&client_addr,
					   sizeof(client_addr), &result,
					   COAP_RESPONSE_CODE_CHANGED, 0,
					   oversize_payload, sizeof(oversize_payload));
	zassert_equal(ret, 0, "respond with fallback failed: %d", ret);

	ret = capture_response(&resp, cap_buf, sizeof(cap_buf), &recv_len,
			       CAPTURE_TIMEOUT_MS);
	zassert_true(ret, "no fallback response captured");
	zassert_true(has_oscore_option(&resp),
		     "fallback response must be OSCORE-protected, not cleartext");

	uint16_t ct_len16 = 0;
	size_t ct_len;
	const uint8_t *ct = coap_packet_get_payload(&resp, &ct_len16);

	ct_len = ct_len16;
	zassert_not_null(ct, "no ciphertext in fallback response");

	uint8_t oscore_opt[32];
	size_t opt_len = sizeof(oscore_opt);
	zassert_equal(coap_oscore_get_option(&resp, oscore_opt, &opt_len),
		      OSCORE_OK, "missing OSCORE option");

	uint8_t code = 0;
	uint8_t dopts[32];
	size_t dopts_len = sizeof(dopts);
	uint8_t dpl[64];
	size_t dpl_len = sizeof(dpl);
	ret = oscore_unprotect_response(client_ctx, piv, sizeof(piv),
					oscore_opt, opt_len, ct, ct_len,
					&code, dopts, &dopts_len, dpl, &dpl_len);
	zassert_equal(ret, OSCORE_OK, "client unprotect of fallback failed: %d", ret);
	zassert_equal(code, COAP_RESPONSE_CODE_INTERNAL_ERROR,
		      "fallback inner code must be 5.00");
	zassert_equal(dpl_len, 0U, "fallback payload must be empty");
}

/*
 * If even the protected empty 5.00 cannot be built (here: the request
 * correlation was already consumed, so the retry hits OSCORE_ERR_REPLAY),
 * the response is dropped silently: negative return, nothing sent.
 */
ZTEST(coap_oscore_fallback, test_protect_failure_twice_drops_silently)
{
	static const uint8_t token[] = {0xC1, 0xC2, 0xC3, 0xC4};
	static const uint8_t piv[] = {0x13};

	uint8_t req_buf[64];
	uint8_t cap_buf[CAPTURE_BUF_LEN];
	static uint8_t consume_buf[CONFIG_COAP_SERVER_MESSAGE_SIZE];
	struct coap_packet req;
	struct coap_packet resp;
	struct coap_oscore_unprotect_result result;
	size_t recv_len = 0;
	int ret;

	ret = build_request(&req, req_buf, sizeof(req_buf), 1003,
			    token, sizeof(token));
	zassert_equal(ret, 0, "request build failed: %d", ret);

	/* Consume the request correlation with a successful protect. */
	struct coap_packet consume_resp;

	ret = coap_oscore_protect_response(server_ctx, piv, sizeof(piv), &req,
					   COAP_RESPONSE_CODE_CHANGED,
					   NULL, 0, NULL, 0,
					   &consume_resp, consume_buf,
					   sizeof(consume_buf));
	zassert_equal(ret, 0, "correlation consume failed: %d", ret);

	memset(&result, 0, sizeof(result));
	result.is_protected = true;
	result.ctx = server_ctx;
	result.origin.response_ctx = server_ref;
	memcpy(result.piv, piv, sizeof(piv));
	result.piv_len = sizeof(piv);

	/* First protect fails (oversized), retry hits the consumed
	 * correlation: the helper must drop the response silently. */
	ret = coap_oscore_respond_resource(&fb_res, &req,
					   (struct sockaddr *)&client_addr,
					   sizeof(client_addr), &result,
					   COAP_RESPONSE_CODE_CHANGED, 0,
					   oversize_payload, sizeof(oversize_payload));
	zassert_true(ret < 0, "double protect failure must return a negative error");
	zassert_false(capture_response(&resp, cap_buf, sizeof(cap_buf), &recv_len,
				       DROP_TIMEOUT_MS),
		      "nothing may be sent to the peer on silent drop");
}

/* A protected request with no context is dropped, never answered in cleartext. */
ZTEST(coap_oscore_fallback, test_protected_no_context_drops)
{
	static const uint8_t token[] = {0xD1, 0xD2, 0xD3, 0xD4};
	static const uint8_t piv[] = {0x14};

	uint8_t req_buf[64];
	uint8_t cap_buf[CAPTURE_BUF_LEN];
	struct coap_packet req;
	struct coap_packet resp;
	struct coap_oscore_unprotect_result result;
	size_t recv_len = 0;
	int ret;

	ret = build_request(&req, req_buf, sizeof(req_buf), 1004,
			    token, sizeof(token));
	zassert_equal(ret, 0, "request build failed: %d", ret);

	memset(&result, 0, sizeof(result));
	result.is_protected = true;
	result.ctx = NULL;
	memcpy(result.piv, piv, sizeof(piv));
	result.piv_len = sizeof(piv);

	ret = coap_oscore_respond_resource(&fb_res, &req,
					   (struct sockaddr *)&client_addr,
					   sizeof(client_addr), &result,
					   COAP_RESPONSE_CODE_CHANGED, 0,
					   NULL, 0);
	zassert_equal(ret, OSCORE_ERR_CONTEXT_STALE,
		      "no-context drop must return CONTEXT_STALE: %d", ret);

	zassert_false(capture_response(&resp, cap_buf, sizeof(cap_buf), &recv_len,
				       DROP_TIMEOUT_MS),
		      "nothing may be sent to the peer on silent drop");
}

/* A protected request with an empty correlation is dropped, never in cleartext. */
ZTEST(coap_oscore_fallback, test_protected_no_piv_drops)
{
	static const uint8_t token[] = {0xE1, 0xE2, 0xE3, 0xE4};

	uint8_t req_buf[64];
	uint8_t cap_buf[CAPTURE_BUF_LEN];
	struct coap_packet req;
	struct coap_packet resp;
	struct coap_oscore_unprotect_result result;
	size_t recv_len = 0;
	int ret;

	ret = build_request(&req, req_buf, sizeof(req_buf), 1005,
			    token, sizeof(token));
	zassert_equal(ret, 0, "request build failed: %d", ret);

	memset(&result, 0, sizeof(result));
	result.is_protected = true;
	result.ctx = server_ctx;
	result.origin.response_ctx = server_ref;
	result.piv_len = 0;

	ret = coap_oscore_respond_resource(&fb_res, &req,
					   (struct sockaddr *)&client_addr,
					   sizeof(client_addr), &result,
					   COAP_RESPONSE_CODE_CHANGED, 0,
					   NULL, 0);
	zassert_equal(ret, OSCORE_ERR_CONTEXT_STALE,
		      "no-piv drop must return CONTEXT_STALE: %d", ret);

	zassert_false(capture_response(&resp, cap_buf, sizeof(cap_buf), &recv_len,
				       DROP_TIMEOUT_MS),
		      "nothing may be sent to the peer on silent drop");
}

/*
 * The plain (unprotected) request path is unchanged: cleartext response,
 * code, token, and payload delivered as requested.
 */
ZTEST(coap_oscore_fallback, test_plain_request_keeps_cleartext)
{
	static const uint8_t token[] = {0xF1, 0xF2, 0xF3, 0xF4};
	static const uint8_t payload[] = "plain";

	uint8_t req_buf[64];
	uint8_t cap_buf[CAPTURE_BUF_LEN];
	struct coap_packet req;
	struct coap_packet resp;
	struct coap_oscore_unprotect_result result;
	size_t recv_len = 0;
	int ret;

	ret = build_request(&req, req_buf, sizeof(req_buf), 1006,
			    token, sizeof(token));
	zassert_equal(ret, 0, "request build failed: %d", ret);

	memset(&result, 0, sizeof(result));
	result.is_protected = false;

	ret = coap_oscore_respond_resource(&fb_res, &req,
					   (struct sockaddr *)&client_addr,
					   sizeof(client_addr), &result,
					   COAP_RESPONSE_CODE_NOT_FOUND, 0,
					   payload, sizeof(payload) - 1);
	zassert_equal(ret, 0, "plain respond failed: %d", ret);

	ret = capture_response(&resp, cap_buf, sizeof(cap_buf), &recv_len,
			       CAPTURE_TIMEOUT_MS);
	zassert_true(ret, "no plain response captured");
	zassert_false(has_oscore_option(&resp),
		      "plain request must not receive an OSCORE-protected response");
	zassert_equal(coap_header_get_code(&resp), COAP_RESPONSE_CODE_NOT_FOUND,
		      "plain code mismatch");

	uint8_t echo_token[COAP_TOKEN_MAX_LEN];
	uint8_t tkl = coap_header_get_token(&resp, echo_token);

	zassert_equal(tkl, sizeof(token), "token length mismatch");
	zassert_mem_equal(echo_token, token, sizeof(token), "token mismatch");

	uint16_t plen = 0;
	const uint8_t *pl = coap_packet_get_payload(&resp, &plen);

	zassert_not_null(pl, "plain payload missing");
	zassert_equal(plen, sizeof(payload) - 1U, "plain payload length mismatch");
	zassert_mem_equal(pl, payload, sizeof(payload) - 1U, "plain payload mismatch");
}
```

## src/endpoint_no_keys.c
```c
/* SPDX-License-Identifier: GPL-3.0-or-later */
/* SPDX-FileCopyrightText: The contributors to the LICHEN project */

#include <string.h>
#include <zephyr/ztest.h>
#include <lichen/coap_oscore.h>

BUILD_ASSERT(!IS_ENABLED(CONFIG_LICHEN_COAP_KEYS), "Exercise optional-store absence");

ZTEST_SUITE(endpoint_no_keys, NULL, NULL, NULL, NULL, NULL);

ZTEST(endpoint_no_keys, test_routable_fails_closed_even_with_suffix_context)
{
	/* Pinned yggdrasil-go 422836ee address_test.go origin. */
	struct sockaddr_in6 source = {.sin6_family = AF_INET6};
	const uint8_t upstream[16] = {
		0x02, 0x00, 0x84, 0x8a, 0x60, 0x4f, 0xbb, 0x7e,
		0x43, 0x84, 0x65, 0xdb, 0x8d, 0xb6, 0x68, 0x95,
	};
	uint8_t peer[8];
	/* RFC 8613 C.4: ciphertext and context, not a local encrypt/decrypt oracle. */
	const uint8_t secret[16] = {1, 2, 3, 4, 5, 6, 7, 8, 9, 10, 11, 12, 13, 14, 15, 16};
	const uint8_t salt[8] = {0x9e, 0x7c, 0xa9, 0x22, 0x23, 0x78, 0x63, 0x40};
	const uint8_t ciphertext[] = {
		0x61, 0x2f, 0x10, 0x92, 0xf1, 0x77, 0x6f, 0x1c,
		0x16, 0x68, 0xb3, 0x82, 0x5e,
	};
	uint8_t wire[64];
	struct coap_packet request;
	struct coap_option options[4];
	struct oscore_ctx *ctx;
	static struct coap_oscore_unprotect_result result;
	const struct coap_oscore_origin empty = {0};

	oscore_init();
	memcpy(source.sin6_addr.s6_addr, upstream, 16);
	memcpy(peer, upstream + 8, 8);
	peer[0] ^= 2;
	zassert_ok(oscore_ctx_create_with_eui64(secret, salt, sizeof(salt),
		(uint8_t[]){1}, 1, NULL, 0, peer, &ctx));
	zassert_ok(coap_packet_init(&request, wire, sizeof(wire), 1,
		COAP_TYPE_CON, 0, NULL, COAP_METHOD_POST, 1));
	zassert_ok(coap_packet_append_option(&request, COAP_OPTION_OSCORE,
		(uint8_t[]){0x09, 0x14}, 2));
	zassert_ok(coap_packet_append_payload_marker(&request));
	zassert_ok(coap_packet_append_payload(&request, ciphertext, sizeof(ciphertext)));
	zassert_ok(coap_packet_parse(&request, wire, request.offset, options, 4));
	zassert_equal(coap_oscore_unprotect_resource_request(NULL, &request,
		(struct sockaddr *)&source, sizeof(source), COAP_METHOD_GET, &result),
		COAP_RESPONSE_CODE_UNAUTHORIZED);
	zassert_mem_equal(&result.origin, &empty, sizeof(empty));
	const uint8_t *payload;
	zassert_equal(coap_oscore_authorize_mutating_with_origin(NULL, &request,
		(struct sockaddr *)&source, sizeof(source), COAP_METHOD_GET,
		result.plainbuf, sizeof(result.plainbuf), &payload, &result.payload_len,
		&result.ctx, result.piv, &result.piv_len, &result.is_protected, &result.origin),
		COAP_RESPONSE_CODE_UNAUTHORIZED);
	zassert_mem_equal(&result.origin, &empty, sizeof(empty));
	zassert_is_null(result.ctx);
	/* Same already provisioned context is usable through established LL handling. */
	memset(source.sin6_addr.s6_addr, 0, 8);
	source.sin6_addr.s6_addr[0] = 0xfe;
	source.sin6_addr.s6_addr[1] = 0x80;
	zassert_ok(coap_oscore_unprotect_resource_request(NULL, &request,
		(struct sockaddr *)&source, sizeof(source), COAP_METHOD_GET, &result));
	zassert_true(result.origin.authenticated);
	oscore_ctx_free(ctx);
}
```

## src/inbox_lifetime.c
```c
/* SPDX-License-Identifier: GPL-3.0-or-later */
/* SPDX-FileCopyrightText: The contributors to the LICHEN project */

#include <string.h>
#include <zephyr/ztest.h>
#include <lichen/coap_server.h>
#include <lichen/coap_oscore.h>
#include <lichen/coap_keys.h>

extern struct coap_resource lichen_msg_inbox;
extern const struct coap_service lichen_coap_server;

/* This suite deliberately keeps the optional key store disabled. */
bool lichen_coap_is_local_admin(const struct sockaddr *addr, socklen_t addr_len)
{
	ARG_UNUSED(addr);
	ARG_UNUSED(addr_len);
	return false;
}

int lichen_key_store_get(const uint8_t iid[LICHEN_KEY_IID_LEN],
	struct lichen_key_entry *entry)
{
	ARG_UNUSED(iid);
	ARG_UNUSED(entry);
	return -ENOENT;
}

int __real_coap_service_start(const struct coap_service *service);
int __wrap_coap_service_start(const struct coap_service *service);
int __wrap_coap_service_start(const struct coap_service *service)
{
	/* Register real application callbacks without starting a dispatch thread;
	 * the tests invoke the real resource's post function directly. */
	return service == &lichen_coap_server ? 0 : __real_coap_service_start(service);
}

static uint8_t sent_packet[CONFIG_COAP_SERVER_MESSAGE_SIZE];
static size_t sent_len;
static unsigned sends;
static unsigned callback_calls;
static bool invalidate_in_callback;
static struct oscore_ctx *ctx;

int __real_coap_resource_send(const struct coap_resource *resource,
	const struct coap_packet *packet, const struct sockaddr *addr,
	socklen_t addr_len, const struct coap_transmission_parameters *params);
int __wrap_coap_resource_send(const struct coap_resource *resource,
	const struct coap_packet *packet, const struct sockaddr *addr,
	socklen_t addr_len, const struct coap_transmission_parameters *params);
int __wrap_coap_resource_send(const struct coap_resource *resource,
	const struct coap_packet *packet, const struct sockaddr *addr,
	socklen_t addr_len, const struct coap_transmission_parameters *params)
{
	if (resource != &lichen_msg_inbox) {
		return __real_coap_resource_send(resource, packet, addr, addr_len, params);
	}
	sends++;
	sent_len = packet->offset;
	zassert_true(sent_len <= sizeof(sent_packet));
	memcpy(sent_packet, packet->data, sent_len);
	return 0;
}

static int deliver_message(const uint8_t *payload, size_t len, uint32_t *msg_id)
{
	static const char expected[] = "{\"message\":\"test\"}";
	callback_calls++;
	zassert_equal(len, sizeof(expected) - 1);
	zassert_mem_equal(payload, expected, len);
	*msg_id = 42;
	if (invalidate_in_callback) {
		oscore_ctx_free(ctx);
		ctx = NULL;
	}
	return 0;
}

static void before(void *fixture)
{
	ARG_UNUSED(fixture);
	/* Independent Python/Rust fixture: oscore_cross_exchange.json,
	 * roundtrip_request_with_payload, sender aa, recipient bb, sequence 42. */
	const uint8_t secret[16] = {
		0xde, 0xad, 0xbe, 0xef, 0xca, 0xfe, 0xba, 0xbe,
		0xde, 0xad, 0xbe, 0xef, 0xca, 0xfe, 0xba, 0xbe,
	};
	const uint8_t salt[8] = {0, 0x11, 0x22, 0x33, 0x44, 0x55, 0x66, 0x77};
	const uint8_t peer[8] = {2, 0, 0, 0, 0, 0, 0, 1};
	const struct lichen_coap_server_handlers handlers = {.msg_post = deliver_message};
	sends = 0;
	sent_len = 0;
	callback_calls = 0;
	invalidate_in_callback = false;
	zassert_ok(oscore_init());
	zassert_ok(oscore_ctx_create_with_eui64(secret, salt, sizeof(salt),
		(uint8_t[]){0xbb}, 1, (uint8_t[]){0xaa}, 1, peer, &ctx));
	zassert_ok(lichen_coap_server_init(&handlers));
}

static void after(void *fixture)
{
	ARG_UNUSED(fixture);
	oscore_ctx_free(ctx);
	ctx = NULL;
	zassert_ok(lichen_coap_server_init(NULL));
}

static int post(void)
{
	const uint8_t ciphertext[] = {
		0xf9, 0xad, 0xeb, 0x44, 0x45, 0x10, 0x48, 0xd5,
		0x3a, 0xed, 0x05, 0x6c, 0x45, 0x40, 0x8e, 0xc3,
		0xa9, 0x1c, 0xf3, 0x89, 0xdf, 0xf9, 0x26, 0x92,
		0xe8, 0xc8, 0xe2, 0xec,
	};
	uint8_t wire[64];
	struct coap_packet request;
	struct coap_option options[4];
	struct sockaddr_in6 source = {.sin6_family = AF_INET6};
	source.sin6_addr.s6_addr[0] = 0xfe;
	source.sin6_addr.s6_addr[1] = 0x80;
	source.sin6_addr.s6_addr[15] = 1;
	zassert_ok(coap_packet_init(&request, wire, sizeof(wire), 1,
		COAP_TYPE_CON, 1, (uint8_t[]){0x31}, COAP_METHOD_POST, 123));
	zassert_ok(coap_packet_append_option(&request, COAP_OPTION_OSCORE,
		(uint8_t[]){9, 42, 0xaa}, 3));
	zassert_ok(coap_packet_append_payload_marker(&request));
	zassert_ok(coap_packet_append_payload(&request, ciphertext, sizeof(ciphertext)));
	zassert_ok(coap_packet_parse(&request, wire, request.offset, options, ARRAY_SIZE(options)));
	return lichen_msg_inbox.post(&lichen_msg_inbox, &request,
		(struct sockaddr *)&source, sizeof(source));
}

ZTEST_SUITE(inbox_lifetime, NULL, NULL, before, after, NULL);

ZTEST(inbox_lifetime, test_callback_invalidation_never_sends_plaintext)
{
	invalidate_in_callback = true;
	int ret = post();
	zassert_equal(ret, OSCORE_ERR_CONTEXT_STALE, "ret=%d sends=%u", ret, sends);
	zassert_equal(callback_calls, 1);
	zassert_equal(sends, 0, "stale context must not emit even an error response");
}

ZTEST(inbox_lifetime, test_normal_callback_sends_protected_created)
{
	/* Independently computed with pyca/cryptography HKDF-SHA256/AESCCM,
	 * tag_length=8. Same context as the cross-implementation request above:
	 * key info=8541bbf60a634b657910, IV info=8540f60a6249560d,
	 * AAD=8368456e63727970743040498501810a41aa412a40, plaintext=41.
	 * The independent calculation also reproduced the request fixture exactly. */
	const uint8_t expected[] = {0x86, 0x25, 0xb1, 0xb4, 0x4d, 0xea, 0x4e, 0xca, 0x4a};
	struct coap_packet response;
	struct coap_option options[8], oscore;
	uint16_t payload_len;
	zassert_ok(post());
	zassert_equal(callback_calls, 1);
	zassert_equal(sends, 1, "sends=%u", sends);
	zassert_ok(coap_packet_parse(&response, sent_packet, sent_len, options, ARRAY_SIZE(options)));
	zassert_equal(coap_find_options(&response, COAP_OPTION_OSCORE, &oscore, 1), 1);
	const uint8_t *payload = coap_packet_get_payload(&response, &payload_len);
	zassert_equal(payload_len, sizeof(expected));
	zassert_mem_equal(payload, expected, sizeof(expected));
	struct coap_option location[3];
	zassert_equal(coap_find_options(&response, COAP_OPTION_LOCATION_PATH, location, 3), 3);
	zassert_equal(location[2].len, 2);
	zassert_mem_equal(location[2].value, "42", 2);
}
```
