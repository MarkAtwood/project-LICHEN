## CMakeLists.txt
```
# SPDX-License-Identifier: GPL-3.0-or-later
# SPDX-FileCopyrightText: The contributors to the LICHEN project

cmake_minimum_required(VERSION 3.20.0)
find_package(Zephyr REQUIRED HINTS $ENV{ZEPHYR_BASE})
project(gnss_l76k_test)

target_sources(app PRIVATE src/main.c)
```

## prj.conf
```kconfig
CONFIG_SERIAL=y
CONFIG_ZTEST=y
CONFIG_ZTEST_STACK_SIZE=2048

CONFIG_LOG=y
CONFIG_GNSS=y
CONFIG_GNSS_LOG_LEVEL_DBG=y
CONFIG_PM_DEVICE=y

# The mock L76K sits on a zephyr,uart-emul node (see boards/native_sim*.overlay):
# it selects SERIAL_SUPPORT_INTERRUPT so UART_INTERRUPT_DRIVEN=y is actually
# satisfiable here, which unblocks the MODEM_BACKEND_UART dependency chain.
CONFIG_EMUL=y
CONFIG_UART_INTERRUPT_DRIVEN=y
CONFIG_MODEM_MODULES=y
CONFIG_MODEM_BACKEND_UART=y
CONFIG_MODEM_CHAT=y

CONFIG_MAIN_STACK_SIZE=2048

# C Safety Policy - spec/appendix-c-safety.md
# STACK_SENTINEL only: STACK_CANARIES is an exclusive choice sibling and
# selecting both aborts the Kconfig run.
CONFIG_STACK_SENTINEL=y
CONFIG_ASSERT=y
CONFIG_ASSERT_VERBOSE=y

# No CONFIG_THREAD_ANALYZER here: it depends on !ARCH_POSIX and this suite
# only builds on native_sim, so assigning it aborts the Kconfig merge
# (project-LICHEN-worker6-52yd). R-APPC-007 applies to hardware builds.
# System heap validation (spec appendix-c-safety.md R-APPC-008, debug builds)
CONFIG_SYS_HEAP_VALIDATE=y
```

## boards/native_sim_native_64.overlay
```dts
/ {
	aliases {
		gnss = &l76k;
	};

	/*
	 * The modem-uart backend requires an interrupt-capable UART
	 * (MODEM_BACKEND_UART depends on UART_INTERRUPT_DRIVEN ||
	 * UART_ASYNC_API), and native_sim's uart1 is a zephyr,native-posix-uart
	 * whose driver has no IRQ API and never selects
	 * SERIAL_SUPPORT_INTERRUPT — assigning UART_INTERRUPT_DRIVEN=y aborts
	 * the Kconfig merge. Mock the L76K on a zephyr,uart-emul node instead
	 * (project-LICHEN-worker6-daz7): it selects SERIAL_SUPPORT_INTERRUPT
	 * and needs no host tty.
	 */
	euart1: uart-emul-1 {
		compatible = "zephyr,uart-emul";
		status = "okay";
		current-speed = <9600>;

		l76k: l76k {
			compatible = "quectel,l76k";
			status = "okay";
		};
	};
};
```

## src/main.c
```c
/* SPDX-License-Identifier: GPL-3.0-or-later */
/* SPDX-FileCopyrightText: The contributors to the LICHEN project */

#include <zephyr/device.h>
#include <zephyr/drivers/gnss.h>
#include <zephyr/ztest.h>

/* Build-validation smoke test for the L76K driver (bead jtl6): the
 * l76k DT node must instantiate and the GNSS API must be reachable.
 * Real NMEA traffic validation is a hardware follow-up
 * (project-LICHEN-2h1i.1.2.2). */
ZTEST(gnss_l76k, test_l76k_device_present)
{
	const struct device *dev = DEVICE_DT_GET(DT_NODELABEL(l76k));

	zassert_true(device_is_ready(dev), "l76k device not ready");
}

ZTEST_SUITE(gnss_l76k, NULL, NULL, NULL, NULL, NULL);
```
