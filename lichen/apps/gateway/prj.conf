## CMakeLists.txt
```
cmake_minimum_required(VERSION 3.20.0)
include(${CMAKE_CURRENT_LIST_DIR}/../../cmake/lichen_build_epoch.cmake)
lichen_configure_time_build_epoch()
find_package(Zephyr REQUIRED HINTS $ENV{ZEPHYR_BASE})
project(lichen_gateway)

target_include_directories(app PRIVATE
  ../../subsys/lichen/transport/include)

target_sources(app PRIVATE
  src/main.c
  src/config_apply.c
  src/config_cbor.c
  src/forwarding.c
  src/forwarding_policy.c
  src/network_location.c
  src/status_cbor.c)
target_sources_ifdef(CONFIG_LICHEN_ROUTING app PRIVATE
  src/announce_ingest.c)
target_sources_ifdef(CONFIG_LORA_LICHEN_BLE app PRIVATE
  src/ble_app_owner.c
  src/ble_uart.c
  src/ble_lci_netif.c
  src/ble_ingress.c
  src/inbound_coap.c
  src/inbound_events.c)
target_sources_ifdef(CONFIG_LORA_LICHEN_MESHTASTIC_BLE app PRIVATE
  src/ble_app_owner.c
  src/ble_meshtastic.c
  src/inbound_coap.c
  src/inbound_events.c
  src/message_contract.c
  src/meshtastic_adapter.c)
target_sources_ifdef(CONFIG_LORA_LICHEN_MESHCORE_BLE app PRIVATE
  src/ble_app_owner.c
  src/ble_meshcore.c
  src/gateway_identity.c
  src/message_contract.c
  src/meshcore_adapter.c)

target_sources_ifdef(CONFIG_LORA_LICHEN_GATEWAY_RPL_ROOT app PRIVATE
  src/rpl_root.c)

# Register the lichen_coap (modular, not _server) iterable section so
# the linker resolves _coap_resource_lichen_coap_list_start / _list_end.
# Standalone server conditionalized off via Kconfig for single owner.
zephyr_linker_sources(DATA_SECTIONS sections-ram.ld)
zephyr_iterable_section(
  NAME coap_resource_lichen_coap
  GROUP DATA_REGION ${XIP_ALIGN_WITH_INPUT}
  SUBALIGN CONFIG_LINKER_ITERABLE_SUBALIGN)
```

## Kconfig
```
# SPDX-License-Identifier: GPL-3.0-or-later
# SPDX-FileCopyrightText: The contributors to the LICHEN project

menu "LICHEN Gateway"

config LICHEN_MESHTASTIC_GATEWAY_ADAPTER_TEST_SURFACE
	bool "Expose Meshtastic gateway adapter surface for ztests"
	depends on ZTEST
	default n
	help
	  Internal ztest hook that exposes Meshtastic gateway adapter CoAP
	  resources without enabling the production BLE GATT backend.

config LICHEN_INBOUND_LOCATION_TEST_SURFACE
	bool "Expose inbound local-client location resource for ztests"
	depends on ZTEST
	default n
	help
	  Internal ztest hook that exposes the local-client location POST
	  resource without enabling a production local-client write transport.

config LICHEN_GATEWAY_ANNOUNCE_NETWORK_LOCATION_FALLBACK
	bool "Publish announce-derived coordinates as approximate NETWORK location"
	default n
	help
	  Allow verified LICHEN announce coordinate metadata from another peer to
	  update the gateway's local NETWORK location as an approximate
	  mesh-derived fallback. Leave disabled unless the gateway profile
	  intentionally wants peer announce coordinates to stand in for local
	  position. Disabled builds still parse and retain announce coordinates
	  for routing/diagnostics, but do not publish them as this node location.

config LORA_LICHEN_BLE
	bool "Native BLE LCI interface"
	depends on BT
	depends on BT_PERIPHERAL
	depends on BT_MAX_CONN = 1
	select LICHEN_APP_INTERFACE
	select NET_L2_DUMMY
	default n
	help
	  Enable the native LICHEN BLE Local Client Interface so a phone can
	  exchange SLIP-framed IPv6 packets with the gateway over BLE GATT.
	  By default this uses LICHEN-specific service and characteristic UUIDs.
	  Gate per board: enable only on targets with an enabled Zephyr BLE HCI
	  device. Keep the HAL BLE-local capability disabled until the board has a
	  validated bidirectional local-client transport.

config LORA_LICHEN_BLE_LEGACY_NUS
	bool "Use legacy Nordic UART Service UUIDs for native BLE LCI"
	depends on LORA_LICHEN_BLE
	default n
	help
	  Keep the native LICHEN BLE LCI surface on the Nordic UART Service UUID
	  triplet for existing mutually exclusive native product images. Do not
	  enable this in images that also need MeshCore compatibility: MeshCore
	  owns NUS UUIDs with raw MeshCore frame semantics.

config NET_IF_MAX_IPV6_COUNT
	default 2 if LORA_LICHEN_BLE

config LORA_LICHEN_MESHTASTIC_BLE
	bool "Meshtastic-compatible BLE GATT interface"
	depends on BT
	depends on BT_PERIPHERAL
	depends on BT_MAX_CONN = 1
	depends on LICHEN_MESHTASTIC_CODEC
	depends on LICHEN_LINK
	depends on !LORA_LICHEN_BLE
	select LICHEN_APP_IDENTITY
	select LICHEN_APP_INTERFACE
	select LICHEN_MESHTASTIC_ADAPTER
	default n
	help
	  Enable the Meshtastic BLE service UUID and raw protobuf
	  ToRadio/FromRadio/FromNum characteristics. This is a local app
	  compatibility surface only; it does not make LICHEN RF packets
	  Meshtastic-compatible. The first implementation owns a single
	  Meshtastic app session and therefore requires CONFIG_BT_MAX_CONN=1.
	  App identity is selected so NodeDB sync can enumerate known LICHEN
	  peers through the common app-visible identity table.

config LORA_LICHEN_MESHCORE_BLE
	bool "MeshCore-compatible BLE GATT interface"
	depends on BT
	depends on BT_PERIPHERAL
	depends on BT_MAX_CONN = 1
	depends on BT_SMP || ZTEST
	depends on BT_FIXED_PASSKEY || ZTEST
	depends on LICHEN_MESHCORE_CODEC
	depends on LICHEN_LINK
	depends on !LORA_LICHEN_BLE
	depends on !LORA_LICHEN_MESHTASTIC_BLE
	select LICHEN_APP_IDENTITY
	select LICHEN_APP_INTERFACE
	select LICHEN_MESHCORE_ADAPTER
	select BT_SMP_ENFORCE_MITM if !ZTEST
	default n
	help
	  Enable the MeshCore-compatible Nordic UART Service UUIDs with raw
	  MeshCore command/response frames. This is a local app compatibility
	  surface only; it does not make LICHEN RF packets MeshCore-compatible.
	  The first implementation owns a single MeshCore app session, requires
	  CONFIG_BT_MAX_CONN=1, CONFIG_BT_SMP, and CONFIG_BT_FIXED_PASSKEY. It
	  uses authenticated encrypted GATT access in production builds. Plain
	  permissions are limited to ztest/native_sim test builds.

config LORA_LICHEN_MESHCORE_BLE_QUEUE_DEPTH
	int "MeshCore BLE frame queue depth"
	depends on LORA_LICHEN_MESHCORE_BLE
	default 4
	range 1 16
	help
	  Number of complete raw MeshCore frames retained for app RX and TX.

config LORA_LICHEN_MESHCORE_BLE_NAME
	string "MeshCore BLE advertised name"
	depends on LORA_LICHEN_MESHCORE_BLE
	default "MeshCore-LICHEN"
	help
	  Short advertised name used only in MeshCore compatibility mode. Keep
	  the default MeshCore- prefix unless real-client smoke tests prove
	  another prefix is discoverable.

config LORA_LICHEN_MESHCORE_BLE_PASSKEY
	int "MeshCore BLE fixed pairing passkey"
	depends on LORA_LICHEN_MESHCORE_BLE
	default 123456
	range 0 999999
	help
	  Six-digit MeshCore compatibility passkey installed with
	  bt_passkey_set() before advertising starts. This is the first
	  product-mode hook for authenticated local pairing; production boards
	  should override it from provisioning or persistent settings once the
	  MeshCore config-secret policy is implemented.

config LORA_LICHEN_MESHCORE_COMPAT_SETTINGS_PERSISTENCE
	bool "Persist MeshCore compatibility-local settings"
	depends on LORA_LICHEN_MESHCORE_BLE || ZTEST
	depends on LICHEN_MESHCORE_ADAPTER
	depends on SETTINGS_NVS
	default n
	help
	  Persist only MeshCore app-compatibility local state through Zephyr
	  settings/NVS: display name, channel 0 compatibility record, auto-add
	  config, default flood scope, and MeshCore BLE PIN. This store is
	  intentionally separate from native LICHEN identity, OSCORE/link keys,
	  group/routing state, and radio configuration.

config LORA_LICHEN_MESHTASTIC_BLE_QUEUE_DEPTH
	int "Meshtastic BLE FromRadio queue depth"
	depends on LORA_LICHEN_MESHTASTIC_BLE
	default 20
	range LORA_LICHEN_MESHTASTIC_BLE_QUEUE_DEPTH_MIN 32
	help
	  Number of complete FromRadio protobuf values retained for app reads.
	  Keep enough headroom for a queued heartbeat plus a full configuration
	  sync burst with the default bounded NodeDB peer cap.

config LORA_LICHEN_MESHTASTIC_BLE_QUEUE_DEPTH_MIN
	int
	default 20

config LORA_LICHEN_MESHTASTIC_BLE_TO_RADIO_QUEUE_DEPTH
	int "Meshtastic BLE ToRadio queue depth"
	depends on LORA_LICHEN_MESHTASTIC_BLE
	default 8
	range 1 16
	help
	  Number of complete ToRadio protobuf values retained for gateway
	  processing after app writes.

config LORA_LICHEN_GATEWAY_MESSAGE_QUEUE_DEPTH
	int "Gateway local message ingress queue depth"
	depends on LORA_LICHEN_MESHTASTIC_BLE || LORA_LICHEN_MESHCORE_BLE || \
		   LICHEN_MESHTASTIC_GATEWAY_ADAPTER_TEST_SURFACE
	default 4
	range 1 16
	help
	  Number of app-ingress text messages accepted from compatibility
	  surfaces and retained for the normal LICHEN message sender. Until that
	  sender is enabled, this bounded queue is the deterministic local
	  contract and does not transmit on BLE or LoRa by itself.

config LORA_LICHEN_GATEWAY_RPL_ROOT
	bool "RPL root signalling"
	depends on LICHEN_RPL
	default y
	help
	  Enable gateway as RPL DODAG root (lichen_rpl_dodag_init_root).
	  Initializes per AGENTS.md order after link_ctx. Drives Trickle DIOs
	  as root for mesh formation. Updates /status to reflect joined root role.

config LICHEN_GATEWAY_PREFIX_DELEGATION
	bool "Enable IPv6 prefix delegation from WiFi/Ethernet backhaul to RPL mesh"
	depends on LICHEN_RPL
	depends on NET_DHCPV6
	depends on NET_IPV6_ND
	# WiFi backhaul boards (heltec_v3, t_deck) enable CONFIG_WIFI in their
	# board .conf. Depending on WIFI instead of selecting it breaks the
	# Zephyr 4.1 Kconfig recursion WIFI -> NET_IPV6 -> NET_CONFIG_AUTO_INIT
	# -> USBD_CDC_ECM_CLASS -> NET_L2_ETHERNET -> WIFI_AIROC -> WIFI that
	# aborted native_sim configure (jy0a).
	depends on WIFI
	select NET_L2_WIFI_MGMT
	select NET_IPV6_ND6
	imply NET_DHCPV6_CLIENT
	default y
	help
	  WiFi STA + upstream prefix to RPL DODAG for Heltec V3 6LBR (spec/appendix-border-router.md).
	  Requires main.c event handlers + AGENTS.md init order. Increases heap (see board defconfig).

config LICHEN_GATEWAY_RX1_DELAY_MS
	int "RX1-style delay before answering a CoAP request (ms)"
	default 0
	help
	  Milliseconds to wait after receiving a CoAP request before sending
	  the response, giving a half-duplex requesting node time to switch
	  its radio from TX (the request it just sent) to RX. Without it, the
	  reply can arrive during the requester's TX->RX turnaround and be
	  missed (lora_ipv6_mesh-fe1z, observed on the T1000-E/LR1110). 0
	  disables the delay. ~100 ms is a safe LoRa value.

# Force modular CoAP (lichen_coap service + LICHEN_COAP_CONFIG) for
# gateway; legacy standalone server (lichen_coap_server) would duplicate
# lichen_config ownership and lacks linker bounds on nucleo_wl55jc/r1_neo.
config LICHEN_COAP_SERVER_STANDALONE
	default n

config LICHEN_GATEWAY_COORDINATION
	bool "Gateway coordination protocol (TDMA slots, node registry, handoff)"
	depends on LICHEN_RPL
	depends on LICHEN_COAP
	depends on LICHEN_COAP_SERVER || LICHEN_COAP_CONFIG
	default n
	help
	  Enable multi-gateway coordination per mugl.3 / spec/05-routing.md:145
	  (backbone UDP/CoAP to /.well-known/lichen-gw). Supports closed (PSK+OSCORE)
	  and open (Ed25519 signatures+TOFU) federation modes. Stubs in subsys and
	  rust/lichen-gateway to follow. Required for >1 gateway deployments.

choice LICHEN_GW_FEDERATION_MODE
	prompt "Gateway federation mode for coordination"
	default LICHEN_GW_FEDERATION_CLOSED
	depends on LICHEN_GATEWAY_COORDINATION
	help
	  Closed: PSK-based for single-operator. Open: signature-based for
	  multi-operator with TOFU. Dual supports both simultaneously (mugl.3).

config LICHEN_GW_FEDERATION_CLOSED
	bool "Closed federation (PSK + OSCORE)"

config LICHEN_GW_FEDERATION_OPEN
	bool "Open federation (Ed25519 + TOFU)"

config LICHEN_GW_FEDERATION_DUAL
	bool "Dual federation (both modes)"

endchoice

config LICHEN_GW_PSK
	string "Base64-encoded PSK for closed/dual federation"
	depends on LICHEN_GATEWAY_COORDINATION
	depends on LICHEN_GW_FEDERATION_CLOSED || LICHEN_GW_FEDERATION_DUAL
	help
	  Shared secret for OSCORE in closed federation. Must match on all
	  cooperating gateways in closed mode. 32+ bytes recommended.

config LICHEN_GATEWAY_WIFI_STATION
	bool "WiFi station backhaul (Heltec V3)"
	default y if BOARD_HELTEC_WIFI_LORA32_V3_ESP32S3_PROCPU
	select WIFI
	select WIFI_NM
	select ESP_WIFI_ENABLED
	help
	  Enable WiFi station mode for internet backhaul, prefix acquisition via RA, and LICHEN_GATEWAY_PREFIX_DELEGATION. Uses net_mgmt events for NET_EVENT_WIFI_CONNECT_RESULT and NET_EVENT_IPV6_ADDR_ADD. SSID/PSK from Kconfig or /config CoAP resource. Follows AGENTS.md init order.

config LICHEN_GATEWAY_WIFI_SSID
	string "WiFi SSID"
	depends on LICHEN_GATEWAY_WIFI_STATION
	default "lichen-backhaul"

config LICHEN_GATEWAY_WIFI_PSK
	string "WiFi PSK"
	depends on LICHEN_GATEWAY_WIFI_STATION
	default "lichen123"
	help
	  WPA2 PSK for station mode. Override via CoAP /config for production.

endmenu

source "Kconfig.zephyr"
```

## prj.conf
```kconfig
# LICHEN gateway — border router / SLIP bridge Kconfig
# Acts as DODAG root (RPL) and SLIP bridge to upstream host

# LoRa radio (driver selected per board in boards/*.conf)
# ponytail: LORA_SX12XX only for external SPI chips (RAK4631, etc)
# STM32WL uses integrated radio via SUBGHZSPI
CONFIG_SPI=y
CONFIG_LORA=y

# Networking
CONFIG_NETWORKING=y
CONFIG_NET_IPV6=y
CONFIG_NET_UDP=y
CONFIG_NET_SOCKETS=y
CONFIG_NET_IPV6_ND=y
CONFIG_NET_DHCPV6=y
CONFIG_NET_PKT_FILTER=y
# NET_ROUTE and NET_ROUTING have no prompt in Zephyr 4.1 (NET_ROUTE defaults
# y if NET_IPV6_NBR_CACHE); assigning them here aborts configure with
# "not directly user-configurable".

# Application protocols
CONFIG_COAP=y
CONFIG_COAP_SERVER=y
CONFIG_COAP_SERVER_WELL_KNOWN_CORE=y
CONFIG_COAP_SERVER_MESSAGE_SIZE=896
CONFIG_ZCBOR=y

# LICHEN protocol stack
CONFIG_LICHEN=y
CONFIG_LICHEN_APP_INTERFACE=y
# main.c calls lichen_app_identity_copy_self() unconditionally (69bf10cdc6);
# LICHEN_APP_IDENTITY is otherwise selected only by the BLE app surfaces,
# which are off in this build (no BT on native_sim).
CONFIG_LICHEN_APP_IDENTITY=y
CONFIG_LICHEN_LINK=y
CONFIG_LICHEN_ROUTING=y
CONFIG_LICHEN_RPL=y
CONFIG_LICHEN_OSCORE=y

# LICHEN CoAP resources
CONFIG_LICHEN_COAP=y
CONFIG_LICHEN_COAP_CONFIG=y

# LICHEN L2 integration (LoRa -> IPv6 stack)
CONFIG_LICHEN_IPV6=y
CONFIG_LICHEN_LORA_L2=y
CONFIG_LICHEN_L2=y

# SLIP bridge
# Base enables NET_DRIVERS; board configs select TAP (sim) or UART (hardware)
CONFIG_NET_DRIVERS=y
CONFIG_SLIP=y

# Larger stacks — gateway handles RPL root duties + forwarding
CONFIG_MAIN_STACK_SIZE=8192
CONFIG_SYSTEM_WORKQUEUE_STACK_SIZE=4096

# Safety (spec appendix-c-safety)
CONFIG_STACK_CANARIES=y
CONFIG_STACK_SENTINEL=y
CONFIG_ASSERT=y
CONFIG_ASSERT_VERBOSE=y

# Logging
CONFIG_LOG=y
CONFIG_LOG_DEFAULT_LEVEL=3
```

## boards/heltec_wifi_lora32_v3_esp32s3_procpu.conf
```kconfig
# SPDX-License-Identifier: GPL-3.0-or-later
# SPDX-FileCopyrightText: The contributors to the LICHEN project
#
# Heltec WiFi LoRa 32 V3 gateway config — ESP32-S3 + SX1262. WiFi backhaul, RPL root,
# tuned stacks, NVS epoch persist, bench provisioning. Update SSID/PSK for production.
# CONFIG_UART_INTERRUPT_DRIVEN=y required for Zephyr shell on UART1
# (polling conflicts with shell backend; see UART driver docs).
#
# WiFi backhaul: NET_L2_ETHERNET + ESP32 WiFi driver. IPv6 RA + NET_IF for
# BR prefix delegation and RPL root. Includes NET_L2_WIFI_MGMT.
CONFIG_LORA_SX126X=y
CONFIG_LICHEN_HAS_LORA=y
CONFIG_LICHEN_RADIO_MODEL_SX126X=y
CONFIG_WIFI_NM=y
CONFIG_ESP_WIFI_ENABLED=y
CONFIG_WIFI=y
CONFIG_NET_L2_ETHERNET=y
CONFIG_NET_L2_WIFI_MGMT=y
CONFIG_NET_IF_MAX_IPV6_COUNT=3
CONFIG_LORA_LICHEN_GATEWAY_RPL_ROOT=y
CONFIG_NET_IPV6_ND=y
CONFIG_NET_CONFIG_NEED_IPV6_ROUTER=y
CONFIG_LICHEN_GATEWAY_PREFIX_DELEGATION=y
CONFIG_LICHEN_GATEWAY_WIFI_SSID="lichen-test"
CONFIG_LICHEN_GATEWAY_WIFI_PSK="lichen123"

CONFIG_SLIP=n

# Full L2 + CoAP path (prj.conf default). Radio arbitration by LICHEN_L2 mutex + TDMA per spec/02a-coordinated-capacity.md §2a.2;
# SHA-256 via mbedTLS, auto-pulled by the LICHEN_L2 select (TinyCrypt is deprecated in Zephyr 4.1).
#
# No AES-CCM link key provisioned on bench gateway -> use CRC32 MIC fallback.
# INSECURE: for bench only; replace with proper key in production.
CONFIG_LICHEN_LINK_INSECURE_CRC32_MIC=y

# Bench-only dev link provisioning for T-Echo and T1000-E pucks (per LICHEN_L2_DEV_PROVISIONING).
CONFIG_LICHEN_L2_DEV_PROVISIONING=y
CONFIG_LICHEN_L2_DEV_PEER_EUI64="7a7ff09dc86c2c10,8a1a2c4b93812cab"

# Dedicated TC TX thread avoids workqueue deadlock with lora_send() on boot.
CONFIG_NET_TC_TX_COUNT=1

# RX-path stacks: the LoRa L2 RX thread runs Monocypher Ed25519 verify +
# SCHC decompress (multi-KB stack), and the net RX thread carries the
# decompressed packet through IPv6/UDP/socket delivery. The 2048/1500
# defaults overflow and crash on the first real received frame. TC TX
# thread runs lichen_l2_send -> Ed25519 SIGNING; 1200 B default
# silently overflows on Xtensa and tramples context — crash appears later
# in xtensa_restore_high_regs. Larger values required for
# ESP32-S3 + WiFi coexistence. Short RX window; boundary-straddling frames safe because
# sx12xx driver holds window open on preamble/header (local Zephyr patch).
# BENCH: 2 dBm prevents saturation on antenna-to-antenna tests while
# allowing >150 B Block2 transfers. The L2 RX path (Ed25519 verify + SCHC
# decompress) runs on the system workqueue since the RX thread was replaced
# by interrupt-driven RX; carry the former RX stack budget here.
CONFIG_SYSTEM_WORKQUEUE_STACK_SIZE=12288
CONFIG_NET_RX_STACK_SIZE=8192
CONFIG_NET_TX_STACK_SIZE=12288

CONFIG_LICHEN_LORA_L2_RX_TIMEOUT_MS=1000
CONFIG_LICHEN_LORA_TX_POWER=2

# Persist the link TX epoch across reboots: advance it +1 each
# boot so the gateway's counter stays ahead of peers' replay windows,
# eliminating the ~50% reboot replay coin-flip. Settings-on-NVS backed by
# the board's storage_partition@250000.
CONFIG_FLASH=y
CONFIG_FLASH_MAP=y
CONFIG_NVS=y
CONFIG_SETTINGS=y
CONFIG_SETTINGS_NVS=y
CONFIG_LICHEN_LINK_EPOCH_PERSIST=y

CONFIG_LICHEN_GATEWAY_RX1_DELAY_MS=100

CONFIG_ESP_WIFI_STATIC_RX_BUFFER_NUM=8
CONFIG_ESP_WIFI_DYNAMIC_RX_BUFFER_NUM=32
CONFIG_ESP_WIFI_STATIC_TX_BUFFER_NUM=8
CONFIG_NET_MAX_ROUTERS=4
CONFIG_NET_IPV6_NBR_CACHE=16
CONFIG_NET_BUF_RX_COUNT=20
CONFIG_HEAP_MEM_POOL_SIZE=98304

# Battery support for Heltec V3 (N30 1100mAh) real hardware test.
CONFIG_LICHEN_HAS_BATTERY=y
CONFIG_SENSOR=y
CONFIG_ADC=y
```

## boards/native_sim.conf
```kconfig
# native_sim board config — overrides / supplements prj.conf

# LoRa loopback driver for testing without external simulator
CONFIG_LORA=y
CONFIG_LORA_LOOPBACK=y

# Alternatively, use the simulator driver (requires lichen-sim running):
# CONFIG_LORA_LICHEN_SIM=y
# CONFIG_LORA_LICHEN_SIM_HOST="127.0.0.1"
# CONFIG_LORA_LICHEN_SIM_PORT=4444
# CONFIG_LORA_LICHEN_SIM_NODE_ID="gw0"
# CONFIG_LORA_LICHEN_SIM_SIM_ID="lichen"
# CONFIG_NET_SOCKETS=y
# CONFIG_NET_SOCKETS_POSIX_NAMES=y

# SLIP via TAP (native_sim only)
CONFIG_SLIP_TAP=y
CONFIG_NET_SLIP_TAP=y
```

## boards/native_sim_native_64.conf
```kconfig
# native_sim board config — overrides / supplements prj.conf

# LoRa loopback driver for testing without external simulator
CONFIG_LORA=y
CONFIG_LORA_LOOPBACK=y
CONFIG_LICHEN_HAS_LORA=y
CONFIG_LICHEN_RADIO_MODEL_LOOPBACK=y

# Alternatively, use the simulator driver (requires lichen-sim running):
# CONFIG_LORA_LICHEN_SIM=y
# CONFIG_LORA_LICHEN_SIM_HOST="127.0.0.1"
# CONFIG_LORA_LICHEN_SIM_PORT=4444
# CONFIG_LORA_LICHEN_SIM_NODE_ID="gw0"
# CONFIG_LORA_LICHEN_SIM_SIM_ID="lichen"
# CONFIG_NET_SOCKETS=y
# CONFIG_NET_SOCKETS_POSIX_NAMES=y

# native_sim uses the LoRa loopback/simulator driver, not Zephyr SLIP/TAP.
CONFIG_SLIP=n

# No SLIP transport on native_sim -> no LICHEN_COAP_KEYS (it requires the
# SLIP transport for admin scoping), and the subsys /config resource module
# (coap_config.c) cannot link without KEYS' local-admin/fingerprint helpers.
# Mirror native_posix_ble_ingress.conf and drop the resource module here;
# the app-local config_apply/config_cbor paths are unaffected.
CONFIG_LICHEN_COAP_CONFIG=n

# GNSS: use emulated driver for native_sim (no UART dependency)
# For real hardware, boards use gnss-nmea-generic with MODEM_BACKEND_UART.
CONFIG_GNSS=y
CONFIG_GNSS_EMUL=y

# Entropy driver for CSPRNG (native_sim uses zephyr,native-posix-rng)
CONFIG_ENTROPY_GENERATOR=y
```

## boards/nucleo_wl55jc.conf
```kconfig
# nucleo_wl55jc board config — hardware-specific overrides

# STM32WL55 integrated SubGHz radio (not external SX12XX)
# ponytail: LORA_SX12XX is for external SPI chips like RAK4631
# The STM32WL uses LORA_STM32WL_SUBGHZ_RADIO via devicetree

# SLIP bridge over UART to upstream host
CONFIG_SLIP=y
CONFIG_SLIP_TAP=y
CONFIG_NET_SLIP_TAP=y
```

## boards/t_deck_esp32s3_procpu.conf
```kconfig
# SPDX-License-Identifier: GPL-3.0-or-later
# SPDX-FileCopyrightText: The contributors to the LICHEN project
#
# LilyGO T-Deck gateway config — ESP32-S3 + SX1262 + WiFi backhaul (border router).
# LICHEN_HAL with board capability boundary: hardware features (BLE/serial/display/GNSS/battery/PMIC/external flash) intentionally disabled pending validation (worker23 follow-up beads for display/input/LCI).
# No SLIP (USB CDC for LCI/console avoids UART_PIPE chosen-node dependency). Bench-only insecure CRC32 MIC + dev provisioning for T-Echo/T1000-E interop.
# TC_TX prevents workqueue deadlock on TX; tuned stacks prevent Xtensa overflows (Ed25519/SCHC/net/WiFi/RPL paths).
# Bench tuning: short RX timeout, low TX power, RX1 delay, NVS epoch persist, WiFi 6LBR + RPL root + prefix delegation.
# Matches test/vectors/ and puck radio settings. Update SSID/PSK/MIC before production.
#
# Use -DEXTRA_CONF_FILE=boards/t_deck_esp32s3_procpu_display_validation.conf (or sd_*) for
# targeted hardware validation; do not rely on FILE_SUFFIX for fragments.

CONFIG_LORA_SX126X=y
CONFIG_LICHEN_HAL=y
CONFIG_LICHEN_BOARD_NAME="LilyGO T-Deck"
CONFIG_LICHEN_HAS_LORA=y
CONFIG_LICHEN_RADIO_MODEL_SX126X=y
CONFIG_WIFI_NM=y
CONFIG_ESP_WIFI_ENABLED=y

# Hardware intentionally disabled pending validation / follow-up Beads.
CONFIG_LICHEN_HAS_BLE_LOCAL=n
CONFIG_LICHEN_HAS_SERIAL_LOCAL=n
CONFIG_LICHEN_HAS_DISPLAY=n
CONFIG_LICHEN_HAS_GNSS=n
CONFIG_LICHEN_HAS_BATTERY=n
CONFIG_LICHEN_HAS_PMIC=n
CONFIG_LICHEN_HAS_EXTERNAL_FLASH=n

# No SLIP (uses USB CDC for LCI/console; avoids UART_PIPE chosen-node dependency).
CONFIG_SLIP=n

# Bench-only insecure link (CRC32 MIC fallback). Enables TX without full key exchange.
# Peers: bench pucks (T-Echo, T1000-E). Replace with proper keys for production.
CONFIG_LICHEN_LINK_INSECURE_CRC32_MIC=y
CONFIG_LICHEN_L2_DEV_PROVISIONING=y
CONFIG_LICHEN_L2_DEV_PEER_EUI64="7a7ff09dc86c2c10,8a1a2c4b93812cab"

# Dedicated TC thread prevents workqueue deadlock on TX (lora_send + SX126x TX-done).
CONFIG_NET_TC_TX_COUNT=1

# Stack sizes prevent overflows on Xtensa (Ed25519/SCHC in L2 RX, net paths).
# Per heltec-9ppq + t-deck fixes. The L2 RX path (Ed25519 verify + SCHC
# decompress) runs on the system workqueue since the RX thread was replaced
# by interrupt-driven RX; carry the former RX stack budget here.
CONFIG_SYSTEM_WORKQUEUE_STACK_SIZE=12288
CONFIG_NET_RX_STACK_SIZE=8192
CONFIG_NET_TX_STACK_SIZE=12288
CONFIG_MAIN_STACK_SIZE=8192

# Bench tuning: short RX timeout, low TX power (avoids saturation), RX1 delay, epoch persist in NVS.
CONFIG_LICHEN_LORA_L2_RX_TIMEOUT_MS=1000
CONFIG_LICHEN_LORA_TX_POWER=2
CONFIG_LICHEN_GATEWAY_RX1_DELAY_MS=100
CONFIG_FLASH=y
CONFIG_FLASH_MAP=y
CONFIG_NVS=y
CONFIG_SETTINGS=y
CONFIG_SETTINGS_NVS=y
CONFIG_LICHEN_LINK_EPOCH_PERSIST=y

# WiFi 6LBR backhaul + RPL root (sl32.1 pattern). Tuned buffers for stability (parity with Heltec V3).
CONFIG_LORA_LICHEN_GATEWAY_RPL_ROOT=y
CONFIG_LICHEN_GATEWAY_PREFIX_DELEGATION=y
CONFIG_LICHEN_GATEWAY_WIFI_SSID="lichen-test"
CONFIG_LICHEN_GATEWAY_WIFI_PSK="lichen123"
CONFIG_WIFI=y
CONFIG_NET_L2_ETHERNET=y
CONFIG_NET_L2_WIFI_MGMT=y
CONFIG_NET_IF_MAX_IPV6_COUNT=3
CONFIG_NET_IPV6_ND=y
CONFIG_NET_CONFIG_NEED_IPV6_ROUTER=y
CONFIG_NET_MAX_ROUTERS=4
CONFIG_NET_IPV6_NBR_CACHE=16
CONFIG_NET_BUF_RX_COUNT=20
CONFIG_ESP_WIFI_STATIC_RX_BUFFER_NUM=8
CONFIG_ESP_WIFI_DYNAMIC_RX_BUFFER_NUM=32
CONFIG_ESP_WIFI_STATIC_TX_BUFFER_NUM=8
CONFIG_HEAP_MEM_POOL_SIZE=131072
```

## boards/native_sim.overlay
```dts
/*
 * native_sim overlay for the LICHEN gateway.
 *
 * Instantiates the loopback LoRa driver for testing without hardware.
 * For full simulation with multiple nodes, switch to "lichen,lora-sim"
 * and update native_sim.conf accordingly.
 */

/ {
	aliases {
		lora0 = &lora_sim;
	};

	chosen {
		zephyr,lora = &lora_sim;
	};

	lora_sim: lora {
		compatible = "lichen,lora-loopback";
		status = "okay";
	};
};
```

## boards/nucleo_wl55jc.overlay
```dts
/*
 * Nucleo-WL55JC — STM32WL55 with built-in sub-GHz radio
 *
 * The STM32WL55 integrates an SX126x-compatible sub-GHz transceiver
 * reachable via the internal SUBGHZSPI peripheral.  The Zephyr board
 * definition exposes it as &subghzspi / the STM32 sub-GHz radio node.
 *
 * References:
 *   boards/arm/nucleo_wl55jc/nucleo_wl55jc.dts
 *   drivers/lora/sx126x.c (subghz variant)
 */

/*
 * &lora is the sub-GHz radio node defined in nucleo_wl55jc.dts.
 * Already enabled by default; nothing to override for basic use.
 * Frequency and power are configured at runtime via LoRa API.
 */
```

## src/ble_uart.c
```c
/* SPDX-License-Identifier: GPL-3.0-or-later */
/* SPDX-FileCopyrightText: The contributors to the LICHEN project */
/*
 * BLE UART bridge — Nordic UART Service (NUS) with SLIP framing.
 *
 * Two NUS characteristics:
 *   RX  (6E400002…) — phone writes SLIP-framed IPv6 packets to the gateway
 *   TX  (6E400003…) — gateway notifies SLIP-framed IPv6 packets to the phone
 *
 * SLIP framing (RFC 1055) is identical to the wired SLIP interface so the
 * client stack works regardless of whether it connects via USB-serial or BLE.
 */

#include "ble_uart.h"

#include <zephyr/bluetooth/bluetooth.h>
#include <zephyr/bluetooth/conn.h>
#include <zephyr/bluetooth/gatt.h>
#include <zephyr/bluetooth/uuid.h>
#include <zephyr/kernel.h>
#include <zephyr/logging/log.h>
#include <zephyr/sys/util.h>

LOG_MODULE_REGISTER(ble_uart, LOG_LEVEL_INF);

/* RFC 1055 SLIP byte values */
#define SLIP_END     0xC0u
#define SLIP_ESC     0xDBu
#define SLIP_ESC_END 0xDCu
#define SLIP_ESC_ESC 0xDDu

/* Maximum IPv6 packet size (RFC 8200 §5) */
#define SLIP_BUF_SIZE 1280u

/* NUS UUIDs — 128-bit, little-endian as Zephyr expects */
#define BT_UUID_NUS_VAL \
	BT_UUID_128_ENCODE(0x6e400001, 0xb5a3, 0xf393, 0xe0a9, 0xe50e24dcca9e)
#define BT_UUID_NUS_RX_VAL \
	BT_UUID_128_ENCODE(0x6e400002, 0xb5a3, 0xf393, 0xe0a9, 0xe50e24dcca9e)
#define BT_UUID_NUS_TX_VAL \
	BT_UUID_128_ENCODE(0x6e400003, 0xb5a3, 0xf393, 0xe0a9, 0xe50e24dcca9e)

static struct bt_uuid_128 nus_svc_uuid = BT_UUID_INIT_128(BT_UUID_NUS_VAL);
static struct bt_uuid_128 nus_rx_uuid  = BT_UUID_INIT_128(BT_UUID_NUS_RX_VAL);
static struct bt_uuid_128 nus_tx_uuid  = BT_UUID_INIT_128(BT_UUID_NUS_TX_VAL);

/* Active connection (NULL when no phone is connected) */
static struct bt_conn *s_conn;

/* Mutex protecting SLIP reassembly state */
static K_MUTEX_DEFINE(s_rx_mutex);

/* Mutex protecting TX buffer */
static K_MUTEX_DEFINE(s_tx_mutex);

/* SLIP reassembly state — protected by s_rx_mutex */
static uint8_t  s_rx_buf[SLIP_BUF_SIZE];
static uint16_t s_rx_len;
static bool     s_rx_esc;

/* --------------------------------------------------------------------------
 * Packet dispatch: phone → mesh
 * -------------------------------------------------------------------------- */

static void slip_dispatch(const uint8_t *pkt, size_t len)
{
	/*
	 * TODO: inject the IPv6 packet into the mesh via the Zephyr net_pkt
	 * API once the RPL/net integration layer lands.  Until then, log and
	 * drop so the BLE UART layer is exercisable independently.
	 */
	LOG_INF("BLE UART RX %zu B (IPv6; mesh injection deferred)", len);
	ARG_UNUSED(pkt);
}

/* --------------------------------------------------------------------------
 * GATT service definition
 * -------------------------------------------------------------------------- */

static ssize_t nus_rx_write(struct bt_conn *conn,
			    const struct bt_gatt_attr *attr,
			    const void *buf, uint16_t len,
			    uint16_t offset, uint8_t flags)
{
	const uint8_t *data = buf;

	ARG_UNUSED(conn);
	ARG_UNUSED(attr);
	ARG_UNUSED(offset);
	ARG_UNUSED(flags);

	k_mutex_lock(&s_rx_mutex, K_FOREVER);

	for (uint16_t i = 0; i < len; i++) {
		uint8_t b = data[i];

		if (s_rx_esc) {
			s_rx_esc = false;
			if (b == SLIP_ESC_END) {
				b = SLIP_END;
			} else if (b == SLIP_ESC_ESC) {
				b = SLIP_ESC;
			}
			/* unknown escape sequence: pass byte through */

			/* Check buffer space BEFORE writing decoded escape byte */
			if (s_rx_len >= sizeof(s_rx_buf)) {
				continue;
			}
			s_rx_buf[s_rx_len++] = b;
		} else if (b == SLIP_ESC) {
			s_rx_esc = true;
		} else if (b == SLIP_END) {
			if (s_rx_len > 0) {
				slip_dispatch(s_rx_buf, s_rx_len);
				s_rx_len = 0;
			}
		} else {
			/* Regular byte — store if buffer has space */
			if (s_rx_len < sizeof(s_rx_buf)) {
				s_rx_buf[s_rx_len++] = b;
			}
		}
	}

	k_mutex_unlock(&s_rx_mutex);
	return len;
}

static void nus_tx_ccc_changed(const struct bt_gatt_attr *attr, uint16_t value)
{
	ARG_UNUSED(attr);
	LOG_INF("BLE UART TX notify %s",
		(value == BT_GATT_CCC_NOTIFY) ? "enabled" : "disabled");
}

/*
 * GATT attribute layout (index → attribute):
 *   0  Primary Service declaration
 *   1  RX Characteristic declaration
 *   2  RX Characteristic value
 *   3  TX Characteristic declaration
 *   4  TX Characteristic value  ← bt_gatt_notify target
 *   5  TX CCCD
 */
#define NUS_TX_VAL_IDX 4

BT_GATT_SERVICE_DEFINE(nus_svc,
	BT_GATT_PRIMARY_SERVICE(&nus_svc_uuid),
	BT_GATT_CHARACTERISTIC(&nus_rx_uuid.uuid,
			       BT_GATT_CHRC_WRITE_WITHOUT_RESP,
			       BT_GATT_PERM_WRITE,
			       NULL, nus_rx_write, NULL),
	BT_GATT_CHARACTERISTIC(&nus_tx_uuid.uuid,
			       BT_GATT_CHRC_NOTIFY,
			       BT_GATT_PERM_NONE,
			       NULL, NULL, NULL),
	BT_GATT_CCC(nus_tx_ccc_changed,
		    BT_GATT_PERM_READ | BT_GATT_PERM_WRITE),
);

/* --------------------------------------------------------------------------
 * Connection management
 * -------------------------------------------------------------------------- */

static const struct bt_data s_ad[] = {
	BT_DATA_BYTES(BT_DATA_FLAGS, BT_LE_AD_GENERAL | BT_LE_AD_NO_BREDR),
	BT_DATA_BYTES(BT_DATA_UUID128_ALL, BT_UUID_NUS_VAL),
};

static void adv_start(void)
{
	int err = bt_le_adv_start(
		BT_LE_ADV_PARAM(BT_LE_ADV_OPT_CONNECTABLE | BT_LE_ADV_OPT_USE_NAME,
				BT_GAP_ADV_FAST_INT_MIN_2,
				BT_GAP_ADV_FAST_INT_MAX_2,
				NULL),
		s_ad, ARRAY_SIZE(s_ad), NULL, 0);

	if (err) {
		LOG_ERR("adv_start failed: %d", err);
	} else {
		LOG_INF("BLE advertising as \"%s\"", CONFIG_BT_DEVICE_NAME);
	}
}

static void on_connected(struct bt_conn *conn, uint8_t err)
{
	if (err) {
		LOG_ERR("BLE connect error %u", err);
		return;
	}
	s_conn = bt_conn_ref(conn);
	k_mutex_lock(&s_rx_mutex, K_FOREVER);
	s_rx_len = 0;
	s_rx_esc = false;
	k_mutex_unlock(&s_rx_mutex);
	LOG_INF("BLE phone connected");
}

static void on_disconnected(struct bt_conn *conn, uint8_t reason)
{
	ARG_UNUSED(conn);
	if (s_conn) {
		bt_conn_unref(s_conn);
		s_conn = NULL;
	}
	LOG_INF("BLE phone disconnected (reason %u)", reason);
	adv_start();
}

BT_CONN_CB_DEFINE(conn_callbacks) = {
	.connected    = on_connected,
	.disconnected = on_disconnected,
};

/* --------------------------------------------------------------------------
 * Public API
 * -------------------------------------------------------------------------- */

int ble_uart_send_slip(const uint8_t *ipv6, size_t len)
{
	/*
	 * Static buffer is safe: BLE stack serializes all sends through the
	 * connection callback, so concurrent calls cannot interleave.
	 * Worst-case SLIP frame: every byte escaped → 2× len, plus 2 END bytes.
	 */
	static uint8_t s_tx_frame[SLIP_BUF_SIZE * 2u + 2u];
	uint16_t fi = 0;
	int rc = 0;

	/*
	 * Capture connection reference atomically. This prevents a race where
	 * s_conn becomes NULL (via on_disconnected) between our check and use.
	 * The reference keeps the connection object valid for our entire send.
	 */
	struct bt_conn *conn = s_conn;

	if (conn == NULL) {
		return -ENOTCONN;
	}
	bt_conn_ref(conn);

	/* Validate input length to prevent overflow */
	if (len > SLIP_BUF_SIZE) {
		rc = -ENOMEM;
		goto out_unref;
	}

	k_mutex_lock(&s_tx_mutex, K_FOREVER);

	/* Encode SLIP frame — check space before each write to prevent overflow */
	s_tx_frame[fi++] = SLIP_END;
	for (size_t i = 0; i < len; i++) {
		if (ipv6[i] == SLIP_END) {
			/* Escape sequence needs 2 bytes + 1 reserved for trailing END */
			if (fi + 2u > sizeof(s_tx_frame) - 1u) {
				rc = -ENOMEM;
				goto out;
			}
			s_tx_frame[fi++] = SLIP_ESC;
			s_tx_frame[fi++] = SLIP_ESC_END;
		} else if (ipv6[i] == SLIP_ESC) {
			/* Escape sequence needs 2 bytes + 1 reserved for trailing END */
			if (fi + 2u > sizeof(s_tx_frame) - 1u) {
				rc = -ENOMEM;
				goto out;
			}
			s_tx_frame[fi++] = SLIP_ESC;
			s_tx_frame[fi++] = SLIP_ESC_ESC;
		} else {
			/* Regular byte needs 1 byte + 1 reserved for trailing END */
			if (fi + 1u > sizeof(s_tx_frame) - 1u) {
				rc = -ENOMEM;
				goto out;
			}
			s_tx_frame[fi++] = ipv6[i];
		}
	}
	s_tx_frame[fi++] = SLIP_END;

	/* Send in chunks ≤ (ATT_MTU − 3) bytes; default MTU gives 20 bytes */
	uint16_t mtu    = bt_gatt_get_mtu(conn);
	uint16_t chunk  = (mtu > 3u) ? (uint16_t)(mtu - 3u) : 20u;

	for (uint16_t off = 0; off < fi; off += chunk) {
		uint16_t n = MIN(chunk, (uint16_t)(fi - off));
		rc = bt_gatt_notify(conn,
				    &nus_svc.attrs[NUS_TX_VAL_IDX],
				    &s_tx_frame[off], n);
		if (rc < 0) {
			goto out;
		}
	}
	rc = 0;

out:
	k_mutex_unlock(&s_tx_mutex);
out_unref:
	bt_conn_unref(conn);
	return rc;
}

int ble_uart_init(void)
{
	int err = bt_enable(NULL);

	if (err) {
		LOG_ERR("bt_enable failed: %d", err);
		return err;
	}
	adv_start();
	return 0;
}
```

## src/ble_uart.h
```c
/* SPDX-License-Identifier: GPL-3.0-or-later */
/* SPDX-FileCopyrightText: The contributors to the LICHEN project */
#pragma once

#include <stddef.h>
#include <stdint.h>

/**
 * Initialise the BLE stack and start advertising the NUS service.
 * Must be called from a thread context (bt_enable blocks).
 *
 * Returns 0 on success, negative errno on failure.
 */
int ble_uart_init(void);

/**
 * Send an IPv6 packet to the connected phone as a SLIP-framed BLE UART
 * notification.  Frames larger than the ATT MTU are split across multiple
 * bt_gatt_notify calls.
 *
 * Returns 0, -ENOTCONN if no phone is connected, -ENOMEM if the SLIP-encoded
 * frame exceeds buffer capacity, or negative errno on other failures.
 */
int ble_uart_send_slip(const uint8_t *ipv6, size_t len);
```

## src/config_cbor.c
```c
/* SPDX-License-Identifier: GPL-3.0-or-later */
/* SPDX-FileCopyrightText: The contributors to the LICHEN project */

#include "config_cbor.h"

#include <errno.h>
#include <string.h>

#include <zcbor_decode.h>

#define CONFIG_KEY_TX_POWER_DBM "tx_power_dbm"
#define CONFIG_KEY_TX_POWER_DBM_LEN (sizeof(CONFIG_KEY_TX_POWER_DBM) - 1u)
#define CONFIG_KEY_MANUAL_LOCATION "manual_location"
#define CONFIG_KEY_MANUAL_LOCATION_LEN (sizeof(CONFIG_KEY_MANUAL_LOCATION) - 1u)
#define MANUAL_LOCATION_KEY_LAT_I "lat_i"
#define MANUAL_LOCATION_KEY_LAT_I_LEN (sizeof(MANUAL_LOCATION_KEY_LAT_I) - 1u)
#define MANUAL_LOCATION_KEY_LON_I "lon_i"
#define MANUAL_LOCATION_KEY_LON_I_LEN (sizeof(MANUAL_LOCATION_KEY_LON_I) - 1u)
#define MANUAL_LOCATION_KEY_HACC_MM "hacc_mm"
#define MANUAL_LOCATION_KEY_HACC_MM_LEN (sizeof(MANUAL_LOCATION_KEY_HACC_MM) - 1u)
#define MANUAL_LOCATION_KEY_SOURCE_NAME "source_name"
#define MANUAL_LOCATION_KEY_SOURCE_NAME_LEN (sizeof(MANUAL_LOCATION_KEY_SOURCE_NAME) - 1u)
#define MANUAL_LOCATION_KEY_AGE_S "age_s"
#define MANUAL_LOCATION_KEY_AGE_S_LEN (sizeof(MANUAL_LOCATION_KEY_AGE_S) - 1u)

static bool valid_manual_location_config(
	const struct lichen_gateway_manual_location_config *manual_location);

size_t lichen_gateway_encode_config_cbor(uint8_t *buf, size_t buf_size,
					 int8_t tx_power_dbm)
{
	if (buf == NULL || buf_size < 16) {
		return 0;
	}

	buf[0] = 0xa1;
	buf[1] = 0x6c;
	(void)memcpy(&buf[2], CONFIG_KEY_TX_POWER_DBM, CONFIG_KEY_TX_POWER_DBM_LEN);
	if (tx_power_dbm >= 0 && tx_power_dbm <= 23) {
		buf[14] = (uint8_t)tx_power_dbm;
		return 15;
	} else if (tx_power_dbm >= 24) {
		buf[14] = 0x18;
		buf[15] = (uint8_t)tx_power_dbm;
		return 16;
	} else if (tx_power_dbm >= -24) {
		buf[14] = (uint8_t)(0x20u + (uint8_t)(-tx_power_dbm - 1));
		return 15;
	} else {
		buf[14] = 0x38;
		buf[15] = (uint8_t)(-tx_power_dbm - 1);
		return 16;
	}
}

static bool put_type_len(uint8_t *buf, size_t cap, size_t *off,
			 uint8_t major, size_t len)
{
	if (len > 23U || *off >= cap) {
		return false;
	}
	buf[(*off)++] = (uint8_t)(major | (uint8_t)len);
	return true;
}

static bool put_tstr(uint8_t *buf, size_t cap, size_t *off,
		     const char *value, size_t len)
{
	if (!put_type_len(buf, cap, off, 0x60, len) || cap - *off < len) {
		return false;
	}
	memcpy(&buf[*off], value, len);
	*off += len;
	return true;
}

static bool put_uint(uint8_t *buf, size_t cap, size_t *off, uint32_t value)
{
	if (*off >= cap) {
		return false;
	}
	if (value <= 23U) {
		buf[(*off)++] = (uint8_t)value;
		return true;
	}
	if (value <= UINT8_MAX && cap - *off >= 2U) {
		buf[(*off)++] = 0x18;
		buf[(*off)++] = (uint8_t)value;
		return true;
	}
	if (value <= UINT16_MAX && cap - *off >= 3U) {
		buf[(*off)++] = 0x19;
		buf[(*off)++] = (uint8_t)(value >> 8);
		buf[(*off)++] = (uint8_t)value;
		return true;
	}
	if (cap - *off < 5U) {
		return false;
	}
	buf[(*off)++] = 0x1a;
	buf[(*off)++] = (uint8_t)(value >> 24);
	buf[(*off)++] = (uint8_t)(value >> 16);
	buf[(*off)++] = (uint8_t)(value >> 8);
	buf[(*off)++] = (uint8_t)value;
	return true;
}

static bool put_int(uint8_t *buf, size_t cap, size_t *off, int32_t value)
{
	if (value >= 0) {
		return put_uint(buf, cap, off, (uint32_t)value);
	}
	if (*off >= cap) {
		return false;
	}
	uint32_t encoded = (uint32_t)(-1LL - (int64_t)value);

	if (encoded <= 23U) {
		buf[(*off)++] = (uint8_t)(0x20U + encoded);
		return true;
	}
	if (encoded <= UINT8_MAX && cap - *off >= 2U) {
		buf[(*off)++] = 0x38;
		buf[(*off)++] = (uint8_t)encoded;
		return true;
	}
	if (encoded <= UINT16_MAX && cap - *off >= 3U) {
		buf[(*off)++] = 0x39;
		buf[(*off)++] = (uint8_t)(encoded >> 8);
		buf[(*off)++] = (uint8_t)encoded;
		return true;
	}
	if (cap - *off < 5U) {
		return false;
	}
	buf[(*off)++] = 0x3a;
	buf[(*off)++] = (uint8_t)(encoded >> 24);
	buf[(*off)++] = (uint8_t)(encoded >> 16);
	buf[(*off)++] = (uint8_t)(encoded >> 8);
	buf[(*off)++] = (uint8_t)encoded;
	return true;
}

size_t lichen_gateway_encode_config_update_cbor(
	uint8_t *buf, size_t buf_size,
	int8_t tx_power_dbm,
	const struct lichen_gateway_manual_location_config *manual_location)
{
	size_t off = 0U;
	size_t manual_count = 2U;
	size_t name_len;

	if (buf == NULL || buf_size == 0U) {
		return 0U;
	}
	if (!put_type_len(buf, buf_size, &off, 0xa0,
			  manual_location == NULL ? 1U : 2U) ||
	    !put_tstr(buf, buf_size, &off, CONFIG_KEY_TX_POWER_DBM,
		      CONFIG_KEY_TX_POWER_DBM_LEN) ||
	    !put_int(buf, buf_size, &off, tx_power_dbm)) {
		return 0U;
	}
	if (manual_location == NULL) {
		return off;
	}
	if (!valid_manual_location_config(manual_location)) {
		return 0U;
	}

	manual_count += manual_location->horizontal_accuracy_mm_valid ? 1U : 0U;
	manual_count += manual_location->age_seconds_valid ? 1U : 0U;
	name_len = strlen(manual_location->source_name);
	manual_count += name_len > 0U ? 1U : 0U;

	if (!put_tstr(buf, buf_size, &off, CONFIG_KEY_MANUAL_LOCATION,
		      CONFIG_KEY_MANUAL_LOCATION_LEN) ||
	    !put_type_len(buf, buf_size, &off, 0xa0, manual_count) ||
	    !put_tstr(buf, buf_size, &off, MANUAL_LOCATION_KEY_LAT_I,
		      MANUAL_LOCATION_KEY_LAT_I_LEN) ||
	    !put_int(buf, buf_size, &off, manual_location->latitude_e7) ||
	    !put_tstr(buf, buf_size, &off, MANUAL_LOCATION_KEY_LON_I,
		      MANUAL_LOCATION_KEY_LON_I_LEN) ||
	    !put_int(buf, buf_size, &off, manual_location->longitude_e7)) {
		return 0U;
	}
	if (manual_location->horizontal_accuracy_mm_valid &&
	    (!put_tstr(buf, buf_size, &off, MANUAL_LOCATION_KEY_HACC_MM,
		       MANUAL_LOCATION_KEY_HACC_MM_LEN) ||
	     !put_uint(buf, buf_size, &off,
		       manual_location->horizontal_accuracy_mm))) {
		return 0U;
	}
	if (manual_location->age_seconds_valid &&
	    (!put_tstr(buf, buf_size, &off, MANUAL_LOCATION_KEY_AGE_S,
		       MANUAL_LOCATION_KEY_AGE_S_LEN) ||
	     !put_uint(buf, buf_size, &off, manual_location->age_seconds))) {
		return 0U;
	}
	if (name_len > 0U &&
	    (!put_tstr(buf, buf_size, &off, MANUAL_LOCATION_KEY_SOURCE_NAME,
		       MANUAL_LOCATION_KEY_SOURCE_NAME_LEN) ||
	     !put_tstr(buf, buf_size, &off, manual_location->source_name,
		       name_len))) {
		return 0U;
	}

	return off;
}

static bool key_is_tx_power_dbm(const struct zcbor_string *key)
{
	return key->len == CONFIG_KEY_TX_POWER_DBM_LEN &&
	       memcmp(key->value, CONFIG_KEY_TX_POWER_DBM,
		      CONFIG_KEY_TX_POWER_DBM_LEN) == 0;
}

static bool key_matches(const struct zcbor_string *key, const char *expected,
			size_t expected_len)
{
	return key->len == expected_len &&
	       memcmp(key->value, expected, expected_len) == 0;
}

static bool valid_lat_lon(int32_t latitude_e7, int32_t longitude_e7)
{
	return latitude_e7 >= -900000000 && latitude_e7 <= 900000000 &&
	       longitude_e7 >= -1800000000 && longitude_e7 <= 1800000000;
}

static bool valid_source_name_bytes(const uint8_t *value, size_t len)
{
	for (size_t i = 0U; i < len; i++) {
		if (value[i] < 0x20U || value[i] > 0x7eU) {
			return false;
		}
	}

	return true;
}

/* Zephyr's minimal libc does not declare strnlen(): bounded length via
 * memchr. A string that fills the buffer without a NUL yields max. */
static size_t config_bounded_len(const char *s, size_t max)
{
	const char *nul = memchr(s, '\0', max);

	return nul ? (size_t)(nul - s) : max;
}

static bool valid_manual_location_config(
	const struct lichen_gateway_manual_location_config *manual_location)
{
	size_t name_len;

	if (manual_location == NULL ||
	    !manual_location->latitude_e7_valid ||
	    !manual_location->longitude_e7_valid ||
	    !valid_lat_lon(manual_location->latitude_e7,
			   manual_location->longitude_e7)) {
		return false;
	}

	name_len = config_bounded_len(manual_location->source_name,
				      sizeof(manual_location->source_name));
	if (name_len == sizeof(manual_location->source_name)) {
		return false;
	}

	return valid_source_name_bytes(
		(const uint8_t *)manual_location->source_name, name_len);
}

static int decode_manual_location(
	zcbor_state_t *zsd,
	struct lichen_gateway_manual_location_config *location)
{
	struct lichen_gateway_manual_location_config decoded = { 0 };
	int32_t value = 0;
	uint32_t uvalue = 0;
	struct zcbor_string tstr;
	bool source_name_seen = false;

	if (!zcbor_map_start_decode(zsd)) {
		return -EINVAL;
	}

	while (!zcbor_array_at_end(zsd)) {
		struct zcbor_string key;
		zcbor_state_t key_state = *zsd;

		if (!zcbor_tstr_decode(zsd, &key)) {
			(void)zcbor_list_map_end_force_decode(zsd);
			return -EINVAL;
		}

		if (key_matches(&key, MANUAL_LOCATION_KEY_LAT_I,
				MANUAL_LOCATION_KEY_LAT_I_LEN)) {
			if (decoded.latitude_e7_valid) {
				(void)zcbor_list_map_end_force_decode(zsd);
				return -EINVAL;
			}
			if (!zcbor_int32_decode(zsd, &value)) {
				(void)zcbor_list_map_end_force_decode(zsd);
				return -EINVAL;
			}
			decoded.latitude_e7 = value;
			decoded.latitude_e7_valid = true;
		} else if (key_matches(&key, MANUAL_LOCATION_KEY_LON_I,
				       MANUAL_LOCATION_KEY_LON_I_LEN)) {
			if (decoded.longitude_e7_valid) {
				(void)zcbor_list_map_end_force_decode(zsd);
				return -EINVAL;
			}
			if (!zcbor_int32_decode(zsd, &value)) {
				(void)zcbor_list_map_end_force_decode(zsd);
				return -EINVAL;
			}
			decoded.longitude_e7 = value;
			decoded.longitude_e7_valid = true;
		} else if (key_matches(&key, MANUAL_LOCATION_KEY_HACC_MM,
				       MANUAL_LOCATION_KEY_HACC_MM_LEN)) {
			if (decoded.horizontal_accuracy_mm_valid) {
				(void)zcbor_list_map_end_force_decode(zsd);
				return -EINVAL;
			}
			if (!zcbor_uint32_decode(zsd, &uvalue)) {
				(void)zcbor_list_map_end_force_decode(zsd);
				return -EINVAL;
			}
			decoded.horizontal_accuracy_mm = uvalue;
			decoded.horizontal_accuracy_mm_valid = true;
		} else if (key_matches(&key, MANUAL_LOCATION_KEY_AGE_S,
				       MANUAL_LOCATION_KEY_AGE_S_LEN)) {
			if (decoded.age_seconds_valid) {
				(void)zcbor_list_map_end_force_decode(zsd);
				return -EINVAL;
			}
			if (!zcbor_uint32_decode(zsd, &uvalue)) {
				(void)zcbor_list_map_end_force_decode(zsd);
				return -EINVAL;
			}
			decoded.age_seconds = uvalue;
			decoded.age_seconds_valid = true;
		} else if (key_matches(&key, MANUAL_LOCATION_KEY_SOURCE_NAME,
				       MANUAL_LOCATION_KEY_SOURCE_NAME_LEN)) {
			if (source_name_seen) {
				(void)zcbor_list_map_end_force_decode(zsd);
				return -EINVAL;
			}
			if (!zcbor_tstr_decode(zsd, &tstr)) {
				(void)zcbor_list_map_end_force_decode(zsd);
				return -EINVAL;
			}
			if (tstr.len >= sizeof(location->source_name)) {
				(void)zcbor_list_map_end_force_decode(zsd);
				return -ENAMETOOLONG;
			}
			if (!valid_source_name_bytes(tstr.value, tstr.len)) {
				(void)zcbor_list_map_end_force_decode(zsd);
				return -EINVAL;
			}
			memcpy(decoded.source_name, tstr.value, tstr.len);
			decoded.source_name[tstr.len] = '\0';
			source_name_seen = true;
		} else {
			(void)zcbor_pop_error(zsd);
			*zsd = key_state;
			if (!zcbor_any_skip(zsd, NULL) ||
			    !zcbor_any_skip(zsd, NULL)) {
				(void)zcbor_list_map_end_force_decode(zsd);
				return -EINVAL;
			}
		}
	}

	if (!zcbor_map_end_decode(zsd) ||
	    !decoded.latitude_e7_valid ||
	    !valid_manual_location_config(&decoded)) {
		(void)zcbor_list_map_end_force_decode(zsd);
		return -EINVAL;
	}

	*location = decoded;
	return 0;
}

static bool key_is_manual_location(const struct zcbor_string *key)
{
	return key_matches(key, CONFIG_KEY_MANUAL_LOCATION,
			   CONFIG_KEY_MANUAL_LOCATION_LEN);
}

int lichen_gateway_decode_config_cbor(
	const uint8_t *buf, size_t len,
	struct lichen_gateway_config_update *update)
{
	bool found_tx_power = false;
	bool found_manual_location = false;
	int32_t decoded_tx_power = 0;

	if (buf == NULL || len == 0 || update == NULL) {
		return -EINVAL;
	}
	*update = (struct lichen_gateway_config_update){ 0 };

	ZCBOR_STATE_D(zsd, 2, buf, len, 1, 0);

	if (!zcbor_map_start_decode(zsd)) {
		return -EINVAL;
	}

	while (!zcbor_array_at_end(zsd)) {
		struct zcbor_string key;
		zcbor_state_t key_state = *zsd;

		if (!zcbor_tstr_decode(zsd, &key)) {
			(void)zcbor_list_map_end_force_decode(zsd);
			return -EINVAL;
		}

		if (key_is_tx_power_dbm(&key)) {
			if (found_tx_power) {
				(void)zcbor_list_map_end_force_decode(zsd);
				return -EINVAL;
			}
			if (!zcbor_int32_decode(zsd, &decoded_tx_power) ||
			    decoded_tx_power < LICHEN_GATEWAY_TX_POWER_MIN_DBM ||
			    decoded_tx_power > LICHEN_GATEWAY_TX_POWER_MAX_DBM) {
				(void)zcbor_list_map_end_force_decode(zsd);
				return -EINVAL;
			}
			found_tx_power = true;
			continue;
		}

		if (key_is_manual_location(&key)) {
			if (found_manual_location) {
				(void)zcbor_list_map_end_force_decode(zsd);
				return -EINVAL;
			}
			if (decode_manual_location(zsd,
						   &update->manual_location) < 0) {
				(void)zcbor_list_map_end_force_decode(zsd);
				return -EINVAL;
			}
			found_manual_location = true;
			continue;
		}

		(void)zcbor_pop_error(zsd);
		*zsd = key_state;

		if (!zcbor_any_skip(zsd, NULL) || !zcbor_any_skip(zsd, NULL)) {
			(void)zcbor_list_map_end_force_decode(zsd);
			return -EINVAL;
		}
	}

	if (!zcbor_map_end_decode(zsd) ||
	    !zcbor_payload_at_end(zsd) ||
	    (!found_tx_power && !found_manual_location)) {
		(void)zcbor_list_map_end_force_decode(zsd);
		return -EINVAL;
	}

	if (found_tx_power) {
		update->tx_power_dbm = (int8_t)decoded_tx_power;
		update->has_tx_power_dbm = true;
	}
	update->has_manual_location = found_manual_location;
	return 0;
}
```

## src/forwarding.h
```c
/* SPDX-License-Identifier: GPL-3.0-or-later */
/* SPDX-FileCopyrightText: The contributors to the LICHEN project */

#ifndef LICHEN_GATEWAY_FORWARDING_H_
#define LICHEN_GATEWAY_FORWARDING_H_

#include <stdint.h>
#include <stddef.h>
#include <stdbool.h>

#include <zephyr/net/net_pkt.h>
#include <zephyr/net/net_if.h>

#include "forwarding_policy.h"

struct lichen_forwarding_stats {
	uint64_t mesh_to_backhaul;
	uint64_t backhaul_to_mesh;
	uint64_t backhaul_to_mesh_dropped_mtu;
	uint64_t forwarding_policy_denied;
	uint64_t tunnel_auth_denied;
};

int lichen_forwarding_init(void);

/**
 * Forwarding-path hook: inspect a packet crossing interfaces and update
 * forwarding/tunnel-auth stats. With CONFIG_LICHEN_TUNNEL_AUTH, mesh-origin
 * egress requires a valid root-issued grant.
 *
 * @return true when the packet may be forwarded, false when it was denied
 *         (the caller must drop it).
 */
bool lichen_forwarding_handle(struct net_pkt *pkt, struct net_if *in_iface,
			      struct net_if *out_iface);

/**
 * Identify the mesh interface for the tunnel egress gate. Egress
 * (mesh iface -> any other iface) requires a valid root-issued grant
 * when CONFIG_LICHEN_TUNNEL_AUTH is on; backhaul -> mesh passes through
 * (border-router ingress is out of tunnel scope).
 */
void lichen_forwarding_set_mesh_iface(struct net_if *iface);

#ifdef CONFIG_LICHEN_TUNNEL_AUTH
#include <lichen/gateway/tunnel_auth.h>

/**
 * Initialize the gateway tunnel authorization context (egress gate).
 * Root material: on a root gateway these are the node's own identity.
 * egress_addr is the node's own primary 02xx address (AddrForKey).
 */
int lichen_gateway_tunnel_auth_init(const uint8_t egress_iid[8],
				    const uint8_t egress_addr[16],
				    const uint8_t root_iid[8],
				    const uint8_t root_pubkey[32]);

/** Adapter for the /.well-known/tunnel-auth CoAP handler. */
struct lichen_tunnel_result lichen_gateway_tunnel_auth_receive(
	const uint8_t *body, size_t body_len, bool oscore_authenticated,
	const uint8_t oscore_sender_iid[8], uint64_t now_seconds);
#endif

int lichen_forwarding_stats_get(struct lichen_forwarding_stats *stats);

int lichen_forwarding_stats_clear(void);

#endif
```
