## firmware/bridge-zephyr/boards/xiao_s3_wio_sx1262.conf
```kconfig
# RETIRED per project-LICHEN-2u26: Seeed XIAO ESP32-S3 + Wio-SX1262.
# No canonical Zephyr board or composite shield (seeed_xiao_esp32s3 + Wio-SX1262).
# Classified FAIL in m5m1.8 bridge audit. Proxy targets: heltec_wifi_lora32_v3.
# Support removed; retained for reference only. See docs/firmware-board-capability-matrix.md.

# ESP32-S3 with native USB CDC for console (retained for reference).

# USB CDC serial console
CONFIG_USB_DEVICE_STACK=y
CONFIG_SERIAL=y
CONFIG_CONSOLE=y
CONFIG_UART_CONSOLE=y

# SPI for SX1262
CONFIG_LORA=y
CONFIG_SPI=y

# GPIO for SX1262 control pins and LED
CONFIG_GPIO=y
```

## firmware/bridge-zephyr/subsys/Kconfig
```kconfig
# SPDX-License-Identifier: GPL-3.0-or-later
# SPDX-FileCopyrightText: The contributors to the LICHEN project

menu "LICHEN Subsystems"

rsource "lichen/Kconfig"

endmenu
```

## firmware/bridge-zephyr/subsys/lichen/Kconfig
```kconfig
# SPDX-License-Identifier: GPL-3.0-or-later
# SPDX-FileCopyrightText: The contributors to the LICHEN project

menuconfig LICHEN
	bool "LICHEN LoRa mesh networking"
	help
	  Enable LICHEN (LoRa IPv6 CoAP Hybrid Extended Network) support.
	  This provides IPv6 networking over LoRa radio with SCHC compression,
	  Ed25519 link signatures, and mesh routing.

if LICHEN

config LICHEN_LORA_L2
	bool "LICHEN LoRa L2 network interface"
	depends on LORA
	depends on NET_L2_VIRTUAL || NET_RAW_MODE
	default y
	help
	  Enable the LICHEN LoRa L2 network interface driver. This bridges
	  Zephyr's IPv6 stack to the LoRa radio, enabling IPv6 packets to
	  be sent and received over LoRa.

config LICHEN_LORA_L2_LOG_LEVEL
	int "LICHEN LoRa L2 log level"
	depends on LICHEN_LORA_L2
	default 3
	range 0 4
	help
	  Log level for LICHEN LoRa L2 driver.
	  0 = Off, 1 = Error, 2 = Warning, 3 = Info, 4 = Debug

config LICHEN_LORA_L2_RX_STACK_SIZE
	int "LICHEN LoRa L2 RX thread stack size"
	depends on LICHEN_LORA_L2
	default 2048
	help
	  Stack size for the LoRa L2 RX thread.

config LICHEN_LORA_L2_RX_PRIORITY
	int "LICHEN LoRa L2 RX thread priority"
	depends on LICHEN_LORA_L2
	default 7
	help
	  Priority for the LoRa L2 RX thread. Lower numbers = higher priority.

config LICHEN_IPV6
	bool "LICHEN IPv6 address utilities"
	default y
	help
	  Enable LICHEN IPv6 address utilities. This handles:
	  - Link-local address derivation from EUI-64
	  - ULA address construction
	  - GUA address construction
	  These are standalone utilities that work with or without
	  Zephyr's full networking stack.

config LICHEN_IPV6_ULA_PREFIX
	string "Default ULA prefix"
	depends on LICHEN_IPV6
	default "fd00:lich:en00::"
	help
	  Default ULA prefix used when no DODAG root provides one.
	  Format: fd00:xxxx:xxxx:: (must be in fd00::/8)

endif # LICHEN
```

## lichen/apps/puck/boards/t_deck_esp32s3_procpu.conf
```kconfig
# SPDX-License-Identifier: GPL-3.0-or-later
# SPDX-FileCopyrightText: The contributors to the LICHEN project
#
# LilyGO T-Deck puck config — ESP32-S3 + SX1262 + LVGL. Matches gateway radio, test/vectors, heltec puck.
CONFIG_LORA_SX126X=y
CONFIG_LICHEN_HAS_LORA=y
CONFIG_LICHEN_RADIO_MODEL_SX126X=y
CONFIG_LICHEN_COAP=y
CONFIG_LICHEN_LORA_L2=y
CONFIG_LICHEN_L2=y
# lichen_coap_request() k_malloc()s per-request state.
CONFIG_HEAP_MEM_POOL_SIZE=4096
# 5 s beacon for bench testing (default 60 s) — matches the nRF pucks.
CONFIG_LICHEN_PUCK_BEACON_INTERVAL_MS=5000
CONFIG_LVGL=y
CONFIG_LV_USE_KEYPAD=y
CONFIG_LV_FONT_MONTSERRAT_14=y
# Battery support for real hardware test (N30 1100mAh).
CONFIG_LICHEN_HAS_BATTERY=y
CONFIG_SENSOR=y
CONFIG_ADC=y

# Resolved merge conflict for project-LICHEN-n6zv (worktree-worker18 heltec/puck configs), project-LICHEN-6jxf etc. Consolidated L2/CoAP/heap/beacon/battery settings across workers. No duplicate code or markers. Matches heltec_wifi_lora32_v3_esp32s3_procpu.conf and gateway patterns.
```

## lichen/apps/puck/boards/t_echo_nrf52840.conf
```kconfig
# T-Echo puck config — nRF52840 + SX1262

CONFIG_LORA_SX126X=y

# USB CDC-ACM console — T-Echo has no USB-UART bridge chip.
# SERIAL must be explicitly enabled: USB_CDC_ACM selects UART_INTERRUPT_DRIVEN
# which depends on SERIAL, but nRF52840 doesn't pull it in without a physical UART.
CONFIG_SERIAL=y
CONFIG_USB_DEVICE_STACK=y
CONFIG_USB_CDC_ACM=y
CONFIG_UART_INTERRUPT_DRIVEN=y
CONFIG_UART_LINE_CTRL=y
CONFIG_RTT_CONSOLE=n
CONFIG_UART_CONSOLE=y
CONFIG_LOG_BACKEND_RTT=n

# USB device identity — distinguishes T-Echo from T1000-E in /dev/serial/by-id/
# T1000-E appears as "LICHEN_Node"; T-Echo appears as "LICHEN_T-Echo".
CONFIG_USB_DEVICE_MANUFACTURER="LICHEN Project"
CONFIG_USB_DEVICE_PRODUCT="LICHEN T-Echo"

# Flash load offset: S140 v6.1.1 ends at 0x25FFF; app starts at 0x26000.
# No MCUboot on T-Echo — Adafruit UF2 bootloader handles OTA directly.
CONFIG_FLASH_LOAD_OFFSET=0x26000

# 5 s beacon for bench testing (default is 60 s)
CONFIG_LICHEN_PUCK_BEACON_INTERVAL_MS=5000

# T-Echo drives LoRa directly — no network stack needed.
# prj.conf enables these for T1000-E; disable here to avoid net thread panic.
CONFIG_NETWORKING=n
CONFIG_NET_IPV6=n
CONFIG_NET_UDP=n
CONFIG_NET_SOCKETS=n
CONFIG_COAP=n
```

## lichen/boards/elecrow/thinknode_m7/Kconfig.defconfig
```kconfig
# SPDX-License-Identifier: GPL-3.0-or-later
# SPDX-FileCopyrightText: The contributors to the LICHEN project

if BOARD_THINKNODE_M7_ESP32S3_PROCPU

config HEAP_MEM_POOL_ADD_SIZE_BOARD
	int
	default 65535 if WIFI && BT
	default 51200 if WIFI
	default 40960 if BT
	default 4096

config LICHEN_POE
	default y

config LICHEN_HAS_PMIC
	default y

endif # BOARD_THINKNODE_M7_ESP32S3_PROCPU
```

## lichen/dts/bindings/lora/lichen,lora-loopback.yaml
```yaml
# SPDX-License-Identifier: Apache-2.0
# SPDX-FileCopyrightText: The contributors to the LICHEN project

description: LoRa loopback driver for testing without hardware
compatible: "lichen,lora-loopback"
include: base.yaml
```

## lichen/dts/bindings/lora/lichen,lora-renode.yaml
```yaml
description: LICHEN Renode LoRa driver (memory-mapped to LichenSubGHz peripheral)
compatible: "lichen,lora-renode"
include: base.yaml

properties:
  reg:
    required: true
```

## lichen/subsys/lichen/Kconfig
```kconfig
# SPDX-License-Identifier: GPL-3.0-or-later
# SPDX-FileCopyrightText: The contributors to the LICHEN project

# LICHEN protocol subsystem Kconfig

menuconfig LICHEN
	bool "LICHEN protocol stack"
	help
	  Enable the LICHEN (LoRa IPv6 CoAP Hybrid Extended Network)
	  protocol stack for mesh networking over LoRa.

if LICHEN

rsource "link/Kconfig"

endif # LICHEN
```

## lichen/subsys/lichen/coap/Kconfig
```kconfig
# SPDX-License-Identifier: GPL-3.0-or-later
# SPDX-FileCopyrightText: The contributors to the LICHEN project

# LICHEN CoAP subsystem Kconfig

menuconfig LICHEN_COAP
	bool "LICHEN CoAP client"
	depends on LICHEN
	select COAP
	select COAP_CLIENT
	help
	  Enable LICHEN CoAP client for making requests to mesh nodes.

if LICHEN_COAP

config LICHEN_COAP_LOG_LEVEL
	int "CoAP client log level"
	default 3
	range 0 4
	help
	  Log level for LICHEN CoAP client:
	  0=off, 1=error, 2=warning, 3=info, 4=debug

endif # LICHEN_COAP
```

## lichen/subsys/lichen/link/Kconfig
```kconfig
# SPDX-License-Identifier: GPL-3.0-or-later
# SPDX-FileCopyrightText: The contributors to the LICHEN project

# LICHEN link layer Kconfig

menuconfig LICHEN_LINK
	bool "LICHEN link layer"
	depends on LICHEN
	help
	  Enable the LICHEN link layer with Schnorr-48 signatures
	  and replay protection.

if LICHEN_LINK

config LICHEN_LINK_SCHNORR
	bool "Schnorr-48 link signatures"
	default y
	help
	  Enable 48-byte Schnorr signatures per draft-lichen-schnorr-00.
	  This provides sender authentication for every link-layer frame.

config LICHEN_LINK_REPLAY_WINDOW
	int "Replay window size (bits)"
	default 64
	range 32 256
	help
	  Size of the per-neighbor replay protection window in bits.
	  Larger values tolerate more out-of-order delivery but use
	  more memory.

config LICHEN_LINK_MAX_NEIGHBORS
	int "Maximum tracked neighbors"
	default 16
	range 4 64
	help
	  Maximum number of neighbors to track replay state for.
	  Each neighbor uses (REPLAY_WINDOW / 8 + 4) bytes of RAM.

config LICHEN_LINK_LOG_LEVEL
	int "Link layer log level"
	default 3
	range 0 4
	help
	  Log level for LICHEN link layer:
	  0=off, 1=error, 2=warning, 3=info, 4=debug

endif # LICHEN_LINK
```

## lichen/subsys/lichen/oscore/Kconfig
```kconfig
# SPDX-License-Identifier: GPL-3.0-or-later
# SPDX-FileCopyrightText: The contributors to the LICHEN project

# LICHEN OSCORE subsystem Kconfig

menuconfig LICHEN_OSCORE
	bool "OSCORE end-to-end CoAP security"
	depends on LICHEN
	select TINYCRYPT
	select TINYCRYPT_AES
	select TINYCRYPT_AES_CCM
	select TINYCRYPT_SHA256
	help
	  Enable OSCORE (RFC 8613) for end-to-end CoAP security.
	  Uses AES-CCM-16-64-128 for encryption and authentication.

if LICHEN_OSCORE

config LICHEN_OSCORE_MAX_CONTEXTS
	int "Maximum OSCORE security contexts"
	default 8
	range 2 32
	help
	  Maximum number of OSCORE security contexts (peers).
	  Each context uses approximately 100 bytes of RAM.

config LICHEN_OSCORE_REPLAY_WINDOW
	int "OSCORE replay window size"
	default 32
	range 16 128
	help
	  Size of the OSCORE replay window in sequence numbers.
	  Larger values tolerate more out-of-order delivery.

config LICHEN_OSCORE_LOG_LEVEL
	int "OSCORE log level"
	default 3
	range 0 4
	help
	  Log level for OSCORE subsystem:
	  0=off, 1=error, 2=warning, 3=info, 4=debug

endif # LICHEN_OSCORE
```
